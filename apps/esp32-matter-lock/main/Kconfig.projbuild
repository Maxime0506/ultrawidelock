## apps/esp32-matter-lock/main/Kconfig.projbuild
```kconfig
menu "Example Configuration"

    config ENABLE_ALIRO_BLE_UWB
        bool "Enable Aliro (Apple Home Key) over BLE + UWB"
        default y
        help
            Advertise the Door Lock cluster's Aliro Provisioning + BLE-UWB
            features and register the Aliro reader delegate, so Apple Home can
            provision an Express (BLE + UWB) Home Key into Wallet for this reader.

    config ENABLE_HA_MQTT
        bool "Publish distance and access events to Home Assistant over MQTT"
        default n
        depends on ENABLE_ALIRO_BLE_UWB
        select WOZ_ALIRO_ACCESS_LISTENER
        help
            Publish UWB distance and Aliro access verdicts straight to a TLS
            MQTT broker, on the topics MQTT Discovery expects, so Home
            Assistant builds the device
            through MQTT Discovery with no host-side agent running. Lock
            control stays on Matter; this carries only what Matter does not
            expose.

            Off by default: it adds esp-mqtt and a TLS session to the image,
            and it is useless until a broker is provisioned. Nothing about a
            broker is compiled in — host, port, login, CA certificate and node
            name are runtime NVS config, set with the `hamqtt` console command.

            Do not set this on its own. Build with `make build HAMQTT=1`, which
            also applies the mbedTLS record sizing in
            sdkconfig.defaults.hamqtt; without it mbedtls_ssl_setup cannot get
            a contiguous 16 KiB input record next to Matter, NimBLE and Wi-Fi,
            and every connection fails with -0x7F00 before the handshake.

endmenu
```

## modules/ultrawidelock_cred_stack/Kconfig
```kconfig
# Aliro stack implementation derived from the published specification.

config ULTRAWIDELOCK_CRED_SOURCE_STACK
	bool "Use the in-tree Aliro source implementation"
	depends on NCS_ALIRO_BLE_UWB
	default y
	help
	  Use the in-tree implementation for the public Aliro symbols consumed
	  by the nRF application. This is the default. The repository build
	  script can explicitly set this to n with ULTRAWIDELOCK_SOURCE=0 for comparison
	  with the legacy Nordic binary.

config ULTRAWIDELOCK_CRED_APDU_BUFFER_SIZE
	int "Aliro session APDU buffer size"
	depends on ULTRAWIDELOCK_CRED_SOURCE_STACK
	default RFAL_FEATURE_ISO_DEP_APDU_MAX_LEN if NFC_DRIVER_STM
	default 512
	help
	  Largest single APDU the session layer buffers, and the base of the
	  BLE frame capacity. Tracks the RFAL ISO-DEP ceiling when the ST NFC
	  driver is present so both paths agree; otherwise stands alone (the
	  PN532 transport chains larger transfers at the ISO-DEP layer).

config ULTRAWIDELOCK_CRED_TRACE
	bool "Trace Aliro BLE/UWB protocol boundaries"
	depends on NCS_ALIRO_BLE_UWB
	help
	  Log advertising data, encrypted BLE transport messages, decrypted UWB
	  messages, session transitions, and a truncated SHA-256 fingerprint of
	  URSK. This is a temporary bring-up facility and may expose credential or
	  device identifiers. Do not enable it in production firmware.
```

## modules/ultrawidelock_dfu/Kconfig
```kconfig
# Delta firmware update for the DWM3001CDK: the halves that live in flash.
#
# This board cannot do a conventional over-the-air update and the arithmetic is
# not close. Two full slots want 844 KB of a 512 KB part; an LZMA-compressed
# secondary still wants ~646 KB; and there is no external flash to stage into.
# What fits is a delta -- 10,906 B measured between two adjacent builds of this
# image.
#
# The two symbols below are deliberately separate and are never both set on one
# image. The applier goes in the BOOTLOADER, because an application cannot
# rewrite the flash it is executing from. The receiver goes in the APPLICATION,
# because the bootloader has no radio.

config ULTRAWIDELOCK_DFU_APPLIER
	bool "Delta patch applier (bootloader side)"
	depends on FLASH
	help
	  Compile the detools in-place patch applier and run it from a SYS_INIT
	  at APPLICATION level, which is after the flash driver is up and before
	  MCUboot's own main().

	  Set this ONLY on the MCUboot image. On the application it would link a
	  patcher that can never safely run.

	  MEASURED at 3,176 B of bootloader flash (29,380 -> 32,556 B), which is
	  why apps/dwm3001cdk-lock/pm_static.yml gives MCUboot 0xA000 rather than the 0x8000
	  it needed before: 0x8000 would have left 212 B free.

	  Nothing happens at boot unless a valid header is found in the
	  patch_staging partition, so the cost on a normal boot is one word read.

if ULTRAWIDELOCK_DFU_APPLIER

config ULTRAWIDELOCK_DFU_APPLIER_LOG
	bool "Print applier progress"
	depends on PRINTK
	help
	  Bench only. MCUboot on this board is built with CONFIG_PRINTK=n and no
	  LOG (apps/dwm3001cdk-lock/sysbuild/mcuboot.conf explains what that is worth), so
	  turning this on also means turning those back on and finding the flash
	  for them.

	  Worth it exactly once: the first time a patch is applied on hardware,
	  when the difference between "declined the patch" and "applied it and
	  produced an image that fails validation" is otherwise invisible.

config ULTRAWIDELOCK_DFU_APPLIER_CHUNK
	int "Patch read buffer, bytes"
	default 256
	range 64 1024
	help
	  How much of the staged patch is read from flash at a time before being
	  handed to detools. Larger is marginally faster and costs BSS. detools
	  itself is a streaming decoder and imposes no minimum.

endif # ULTRAWIDELOCK_DFU_APPLIER

config ULTRAWIDELOCK_DFU_RECEIVER
	bool "Delta patch receiver (application side)"
	depends on FLASH && SETTINGS
	depends on PSA_WANT_ALG_ECDSA && PSA_WANT_ECC_SECP_R1_256
	help
	  Receive a signed delta patch into the patch_staging partition and
	  reboot into the bootloader, which applies it.

	  Set this ONLY on the application image. It writes to flash and checks
	  a signature; it never patches anything, because it is executing from
	  the slot a patch rewrites.

	  Transport-independent. On the DWM3001CDK it is fed from a second L2CAP
	  CoC beside the credential one, but nothing in the receiver knows that.

	  NOTHING IS ACCEPTED until ultrawidelock_dfu_window_open() has been called. That
	  window is the authorization: the patch is signed and MCUboot re-checks
	  the result, so no peer can install code either way, but a closed
	  channel is what stops an unauthenticated peer in radio range from
	  burning flash cycles and forcing reboots.

if ULTRAWIDELOCK_DFU_RECEIVER

config ULTRAWIDELOCK_DFU_WINDOW_MS
	int "How long an update window stays open, milliseconds"
	default 300000
	range 10000 3600000
	help
	  Five minutes by default: long enough to push a patch over a connection
	  interval that Matter and credential are also using, short enough that an
	  owner who opened it and walked away is not leaving it open all day.

config ULTRAWIDELOCK_DFU_SMP_IMG
	bool "Serve SMP group 1, so stock mcumgr clients can push an update"
	depends on MCUMGR
	help
	  Answer the mcumgr image-management group with the receiver above, so
	  that nRF Device Manager, nRF Connect for iOS or the `mcumgr` CLI can
	  upload a patch without any bespoke tooling on the other end.

	  This does NOT enable Zephyr's CONFIG_MCUMGR_GRP_IMG, which cannot be
	  built on this board at all:

	    unsatisfied dependencies: IMG_MANAGER (=n),
	                              (!MCUBOOT_BOOTLOADER_MODE_SINGLE_APP) (=n)

	  img_mgmt is gated off by single-slot mode itself, and single-slot mode
	  is what makes MCUboot fit in a 512 KB part. src/dfu_smp_img.c serves
	  the same group ID instead, forwarding every byte to the same checks.

	  The window gate still applies: uploads and erases are refused with
	  ACCESS_DENIED until the owner opens an update window.

	  You must also set CONFIG_MCUMGR_TRANSPORT_BT and a permission choice.
	  Note what that costs -- MCUMGR_TRANSPORT_BT_PERM_RW hands an
	  unpaired peer the SMP endpoint, and only the window gate stands in
	  front of it. The native L2CAP transport needs no such setting.

module = ULTRAWIDELOCK_DFU
module-str = ultrawidelock_dfu
source "subsys/logging/Kconfig.template.log_config"

endif # ULTRAWIDELOCK_DFU_RECEIVER
```

## modules/ultrawidelock_ml/Kconfig
```kconfig
# On-device classifiers. Nothing here is on by default.

config ULTRAWIDELOCK_ML_LOS
	bool "Line-of-sight / obstructed classifier from DW3000 receive diagnostics"
	help
	  Compile the decision tree that says whether the direct path between the
	  reader and the phone is obstructed, from the receiver's own diagnostics
	  rather than from the ranging distance. An obstructed 1 m and a clear 3 m
	  produce similar time-of-flight estimates and do not mean the same thing.

	  MEASURED on arm-none-eabi-gcc 16.1.0 for Cortex-M4F at -Os, per section:

	    ultrawidelock_ml_los_classify        236 B   quantise + call, scaler folded in
	    the tree                    74 B   2 integer comparisons
	    range correction           120 B   20*log10(d) without libm
	    its log2 table              36 B   .rodata, 9 x float32
	    ----------------------------------
	    classifier                 466 B
	    ultrawidelock_ml_los_fp_resid         16 B   only if called
	    ultrawidelock_ml_los_vendor           20 B   only if called
	    ultrawidelock_ml_los_disagrees        32 B   only if called

	  There is no separate scaler in .rodata any more: at two features GCC folds
	  lo[] and scale[] into ultrawidelock_ml_los_classify as immediates, which is why that
	  function grew from 152 B while the 32 B array disappeared.

	  and 0 B of RAM: .data and .bss are both empty. There is no arena, no
	  interpreter and no allocation, so there is nothing to fail at init and
	  nothing to size. The only runtime cost is 28 B of stack for the quantised
	  feature vector. 466 B is 0.9% of the shipping image's free flash.

	  The model is a decision tree because that won a measured bake-off against
	  an int8 TensorFlow Lite Micro network and a random forest, on accuracy
	  per byte. It is also the only one of
	  the three whose generated C can be proved identical to the model that was
	  trained, which is why the host suite can certify it rather than merely
	  regression-pin it. Depth 2 rather than the 4 the public set preferred:
	  on this board's captures a deeper tree scores worse on every split that
	  holds out a whole capture (0.7729 at depth 2, 0.7310 at 3, 0.7011 at 4).

	  TWO FEATURES, AND ONE OF THEM IS NOT A RAW REGISTER. fp_resid is
	  first-path power with free-space spreading at the measured range removed,
	  fp_pwr + 20*log10(d / 1 m). An obstructed 1 m and a clear 3 m produce
	  similar absolute power, which is this classifier's founding problem, and
	  it is only a problem while the model does not know which of the two it is
	  looking at. Worth +13.5 points over the four absolute features on the
	  strictest split available, at two fewer features (RESULTS.md Result 11).
	  The log is a nine-entry table and a leading-bit exponent rather than
	  log10f, so this module still links no libc: `arm-none-eabi-nm -u` on it
	  reports not one undefined symbol.

	  EVERYTHING IT NEEDS, THE HARDWARE ALREADY PRODUCES. rx_pwr and the fp_pwr
	  behind fp_resid come from dwt_readdiagnostics alone (ipatovPower,
	  ipatovF1..F3, ipatovAccumCount) and the range comes from the DS-TWR round
	  the reader already completes. The ten channel-shape features the public
	  set offered need the 64-tap CIR window, and on the DWM3001CDK an image
	  that reads the accumulator cannot range at all, so a seam wanting them
	  would be an API firmware could never call (RESULTS.md Result 7).

	  THE RANGE MAY LAG BY A ROUND. A DS-TWR round yields its distance when the
	  round completes while diagnostics are read per reception, so a caller
	  classifying every reception holds the previous round's range. That is
	  also what the training data measured, since the captured range came from
	  a status line printed every ~2 s, so a lagged range is the case the
	  numbers above are about rather than an approximation of it.

	  ENABLING THIS LINKS THE CLASSIFIER, NOT A DECISION. Nothing in the
	  ranging path calls it, and the feature extractor that would turn a
	  dwt_rxdiag_t into those four floats is unwritten.

	  THE THRESHOLDS ARE THIS BOARD'S, from 556 walk-up receptions captured on
	  a DWM3001CDK against an iPhone: 267 unobstructed over two sessions and
	  289 with the phone shielded by the wearer's body over two geometries
	  (held behind the back and carried in a back pocket, d = +0.06 on fp_pwr
	  between them). Balanced accuracy 0.8505 +/- 0.0302 over 5-fold
	  cross-validation repeated ten times on the four absolute features, and
	  0.8800 +/- 0.0251 for the two shipped, against 0.7431 +/- 0.0359 for
	  Decawave's own rule refit on the same data: RESULTS.md Results 9 and 11.
	  Twelve of those receptions carry no usable range and are dropped when the
	  residual is used, so the shipped model is fitted on 544 of the 556.

	  BOTH SIDES GENERALISE, and that is measured rather than assumed. Holding
	  out a whole capture entirely, the shipped pair scores 0.7729 against
	  0.6381 for the four absolute features, and both clear the 0.7431 vendor
	  floor. The unobstructed sessions are NOT identical: d = +0.69 on fp_pwr
	  between two an hour apart, about 2.9 dB, roughly a third of the
	  obstruction signal itself. Taking the range out of the power is what
	  most of the +13.5 points is buying back. Session drift is still real and
	  is why to retrain at an install rather than treat these as universal.

	  WHAT THAT DOES NOT COVER. One room, one phone, one person, one day. The
	  generation gates below are also weaker than they read: sized for the
	  public set's 42,000 samples, they now run on 544, which leaves 82 in the
	  held-out split. They still prove the generated C is the model that was
	  trained; they prove it over far less ground. Recapture at any install
	  whose geometry differs, which at 466 B is cheaper than transferring.

if ULTRAWIDELOCK_ML_LOS

module = ULTRAWIDELOCK_ML
module-str = ultrawidelock_ml
source "subsys/logging/Kconfig.template.log_config"

endif # ULTRAWIDELOCK_ML_LOS
```
