## CMakeLists.txt
```
# DWM3001CDK standalone Aliro reader — stage 0 skeleton.
#
# Purpose of this stage is a NUMBER, not a feature: link the real reader engine,
# the real CCC/FiRa responder, the real DW3110 driver and a real BLE stack into
# one nRF52833 image and see what it weighs against the 480 KB the single-image
# partition layout gives us.
#
# woz_uwb and modules/woz_dw3000 come in as Zephyr modules because they carry their own
# Kconfig gating. modules/woz_aliro's reader core is listed
# directly here, the way ports/nrf5340dk/on_target_ec does, so the nRF5340 build
# that consumes that module through CONFIG_WOZ_ALIRO_STACK stays untouched.
cmake_minimum_required(VERSION 3.20.0)

get_filename_component(REPO_ROOT "${CMAKE_CURRENT_LIST_DIR}/.." ABSOLUTE)
# modules/woz_aliro is listed for its Kconfig alone: the reader sources use the
# LOG_MODULE the `module = WOZ_ALIRO` template declares, so CONFIG_WOZ_ALIRO_LOG_LEVEL
# has to exist. Its CMakeLists is gated on CONFIG_WOZ_ALIRO_STACK, which stays n
# here, so it contributes no sources and the nRF5340 build is unaffected.
# modules/woz_anchor is listed on the same terms: its CMakeLists is gated on
# CONFIG_WOZ_ANCHOR, which is default n, so listing it here costs the default
# build nothing and only makes `overlay-anchor.conf` able to turn it on.
# modules/woz_ml likewise, gated on CONFIG_WOZ_ML_LOS: default n, so the shipping
# image is byte-identical without it and only overlays/mlgate.conf turns it on.
list(APPEND ZEPHYR_EXTRA_MODULES
	"${REPO_ROOT}/modules/woz_aliro"
	"${REPO_ROOT}/modules/woz_anchor"
	"${REPO_ROOT}/modules/woz_matter"
	"${REPO_ROOT}/modules/woz_ml"
	"${REPO_ROOT}/modules/woz_uwb"
	"${REPO_ROOT}/modules/woz_dw3000"
	"${REPO_ROOT}/ports/zephyr")

find_package(Zephyr REQUIRED HINTS $ENV{ZEPHYR_BASE})
project(aliro_reader_dwm3001cdk)

# APPROTECT must never be locked on this board. SystemInit() re-asserts the lock
# on every boot and the only way out is `nrfjprog --recover`, which mass-erases
# flash AND UICR -- taking settings_storage at 0x7e000 with it, and with that the
# reader private key and every iPhone key already provisioned against this board.
#
# This is the configure-time half of the guard: it fails the build of THIS image
# before a hex exists. scripts/check-approtect.sh is the other half and is the
# one that covers MCUboot, whose config lives outside this CMakeLists entirely.
# Both are needed -- the setting can arrive from a board defconfig or an SoC
# default that no grep of this tree would find, which is why the check that
# matters reads the GENERATED .config.
if(CONFIG_NRF_APPROTECT_LOCK OR CONFIG_NRF_SECURE_APPROTECT_LOCK)
	message(FATAL_ERROR
		"APPROTECT lock is enabled for this image. Refusing to build.\n"
		"  CONFIG_NRF_APPROTECT_LOCK        = ${CONFIG_NRF_APPROTECT_LOCK}\n"
		"  CONFIG_NRF_SECURE_APPROTECT_LOCK = ${CONFIG_NRF_SECURE_APPROTECT_LOCK}\n"
		"Locking is a one-way door for this board's DATA: recovering debug "
		"access costs a mass erase of flash and UICR, which destroys "
		"settings_storage and the reader identity. Export it first with "
		"`aliro export yes` if you genuinely intend this.")
endif()

set(ALIRO "${REPO_ROOT}/modules/woz_aliro")
set(PORTZ "${REPO_ROOT}/ports/zephyr")

# Reader-role source sets come from the role manifests (modules/woz_aliro/
# roles/*.list) — the same lists the ESP32 components, the nRF5340 apps and the
# host suite read, so each role's file set exists in exactly one place.
include("${REPO_ROOT}/cmake/woz_roles.cmake")
woz_role_sources("${ALIRO}/roles/reader.list" ALIRO_READER_SRCS)
woz_role_sources("${ALIRO}/roles/reader_policy.list" ALIRO_POLICY_SRCS)
woz_role_sources("${ALIRO}/roles/apdu.list" ALIRO_APDU_SRCS)
woz_role_sources("${ALIRO}/roles/crypto.list" ALIRO_CRYPTO_SRCS)
woz_role_sources("${ALIRO}/roles/hash.list" ALIRO_HASH_SRCS)
woz_role_sources("${ALIRO}/roles/dyntag.list" ALIRO_DYNTAG_SRCS)
woz_role_sources("${ALIRO}/roles/ble_central.list" ALIRO_BLE_CENTRAL_SRCS)

target_sources(app PRIVATE
	src/main.c
	# Platform seams the reader engine links against, re-homed to ports/zephyr
	# with the rest of the Zephyr glue. Listed by path rather than compiled by
	# the woz_zephyr_port module because they are unconditional app glue with
	# no Kconfig gate to ride — this app IS the gate.
	${PORTZ}/ble/aliro_ble_zephyr.c
	${PORTZ}/store/aliro_prov_settings.c
	# Reader engine: roles reader + reader_policy + apdu + crypto + hash + dyntag.
	${ALIRO_READER_SRCS}
	${ALIRO_POLICY_SRCS}
	${ALIRO_APDU_SRCS}
	${ALIRO_CRYPTO_SRCS}
	${ALIRO_HASH_SRCS}
	${ALIRO_DYNTAG_SRCS}
)
# Provisioning console (USB CDC-ACM, provisioning mode only).
target_sources_ifdef(CONFIG_ALIRO_PROV_CONSOLE app PRIVATE src/prov_shell.c)
# Measurement only; CONFIG_ALIRO_THREAD_GATE defaults n so this is absent from
# every shipping image.
target_sources_ifdef(CONFIG_ALIRO_THREAD_GATE app PRIVATE src/thread_gate.c)
# The DFU receiver's BLE transport (ports/zephyr/dfu/dfu_ble_zephyr.c) and the
# rest of the gated Zephyr glue compile via the woz_zephyr_port module under
# the same CONFIG symbols.
# The board's only output. NOT gated on the DFU receiver any more: the update
# window was the first thing worth showing, not the only one, and the `reader`
# image has no receiver and used to light nothing at all.
target_sources_ifdef(CONFIG_ALIRO_STATUS_LED app PRIVATE src/status_led.c)
target_sources_ifdef(CONFIG_ALIRO_CIRDIAG_CAPTURE app PRIVATE src/cirdiag_capture.c)
target_sources_ifdef(CONFIG_ALIRO_CASE_BENCH app PRIVATE src/case_bench.c)
# Initiator (User-Device role) transport: woz_zephyr_port compiles the central
# mirror of aliro_ble_zephyr.c under this gate; the platform-free advert/READ
# decoder it calls is the same translation unit the ESP32 port and the host
# suite compile.
target_sources_ifdef(CONFIG_ALIRO_BLE_CENTRAL app PRIVATE ${ALIRO_BLE_CENTRAL_SRCS})
# The commissioning policy half; its transport, Thread/fabric ports and fabric
# table store live in ports/zephyr/{matter,store} under the same gate.
target_sources_ifdef(CONFIG_ALIRO_MATTER_BLE app PRIVATE src/matter_commission.c)

# CONFIG_MBEDTLS_MEMORY_DEBUG=y is a NO-OP in this build and sets no define.
# nrf_security only wires that symbol through configs/legacy_crypto_config.h.template
# (`#cmakedefine MBEDTLS_MEMORY_DEBUG`, line 1268); a PSA-only build
# (CONFIG_OBERON_ONLY_PSA_ENABLED) generates nrf-config.h from a different
# template that has no slot for it, so the Kconfig is accepted and silently
# dropped. The app then compiles against a declaration the library never
# defined and the link fails on mbedtls_memory_buffer_alloc_max_get.
#
# Define it for every target instead. Safe because the only struct it changes,
# buffer_alloc_ctx, is file-local to mbedtls/library/memory_buffer_alloc.c, so
# there is no layout to get out of step across compilation units.
if(CONFIG_ALIRO_HEAP_PROBE)
	zephyr_compile_definitions(MBEDTLS_MEMORY_DEBUG)
endif()
# src for matter_commission.h (included by the re-homed aliro_ble_zephyr.c);
# ${PORTZ}/{matter,store} for the re-homed matter_ble_zephyr.h and
# matter_fab_settings.h, which main.c and matter_commission.c include
# regardless of CONFIG_ALIRO_MATTER_BLE.
target_include_directories(app PRIVATE ${ALIRO}/include ${ALIRO}/src src
	${PORTZ}/matter ${PORTZ}/store)
```

## prj.conf
```kconfig
# DWM3001CDK standalone Aliro reader.
#
# The whole file is written against one constraint: 480 KB of code space, from
# the single-image partition layout in boards/decawave_dwm3001cdk.overlay. The
# stock board map would have given the app 224 KB, which is not enough. Every
# "=n" below is load-bearing, not tidiness.

CONFIG_SIZE_OPTIMIZATIONS=y

# ---- BLE: peripheral only, one connection, no bonding -----------------------
# Aliro runs its own application-layer secure channel over the L2CAP CoC, so
# BLE pairing/bonding buys nothing and costs both flash and a walk-up prompt.
# The shipped ESP32-S3 reader is unpaired for the same reason and unlocks a
# real iPhone Wallet key.
CONFIG_BT=y
CONFIG_BT_PERIPHERAL=y
CONFIG_BT_CENTRAL=n
CONFIG_BT_OBSERVER=n
CONFIG_BT_BROADCASTER=y
CONFIG_BT_MAX_CONN=1
CONFIG_BT_MAX_PAIRED=0
# SMP is compiled in only because Zephyr makes L2CAP CoC depend on it
# (zephyr/subsys/bluetooth/host/Kconfig.l2cap:49) — NimBLE does not, which is
# why the ESP32 port never needed this. It is never exercised: the GATT
# characteristics carry no _ENC/_AUTHEN permission, the L2CAP server sits at
# BT_SECURITY_L1, and nothing calls bt_conn_set_security. So the reader still
# never asks a phone to pair, which is the property the live-iPhone unlock
# depends on. Costed at stage 0 rather than assumed away.
CONFIG_BT_SMP=y
CONFIG_BT_BONDABLE=n
CONFIG_BT_SIGNING=n
CONFIG_BT_GATT_CACHING=n
CONFIG_BT_GATT_DYNAMIC_DB=n
CONFIG_BT_DEVICE_NAME="openaliro"

# Connection interval: ask for 15-30 ms instead of riding whatever iOS picks.
#
# Every BLE flow on this board is round-trip bound, and one of them pays triple:
# the 255 B ACL buffer below splits a 512 B Aliro APDU across three PDUs, so an
# APDU costs up to three connection events in each direction. BTP fragments,
# CoC APDUs and DFU chunks all scale straight off the interval.
#
# This is Kconfig rather than a bt_conn_le_param_update() call BECAUSE of how
# the Zephyr peripheral works: that call does NOT send anything while the
# post-connect timer is still pending (host/conn.c:3786) -- it only stores the
# parameters for the timer to use. The request goes out when
# BT_CONN_PARAM_UPDATE_TIMEOUT fires, so the timeout IS the lever, and the PREF
# values are what gets sent. Adding a call site would have changed nothing.
#
# 300 ms rather than the stock 5,000: the whole walk-up transaction is ~650 ms,
# so a request at 5 s arrives after every flow it could have helped. The link
# layer needs >= 6 connection events of instant delay anyway, so the faster
# interval lands mid-transaction, not at its start.
#
# 12/24/0/200 = 15-30 ms, no latency, 2 s supervision. Valid per
# hci_core.c:1947-1960 and inside Apple's accessory guideline (min >= 15 ms,
# max >= min + 15 ms).
#
# MEASURED, and the reason the window is back to 12-24 rather than something
# cleverer: this iPhone grants 30 ms whatever it is asked for. Both 12-24 and
# 12-18 (a range whose only multiple of 15 ms is 15) came back as
# "interval 30.00 ms, latency 0, timeout 2000 ms" on 2026-08-06, on the
# commissioning link and again on the walk-up link. It honours the latency and
# the supervision timeout and picks the interval itself, so 30 ms is this
# phone's floor for this accessory and not a thing this end can bargain over.
# What survives is worth keeping -- 2 s of supervision instead of Zephyr's
# 420 ms default, and a request that arrives in time to matter if any other
# central (Android, a Home Assistant host, a controller doing DFU) does grant
# it -- but do not expect a faster walk-up from this knob on iOS.
CONFIG_BT_CONN_PARAM_UPDATE_TIMEOUT=300
CONFIG_BT_PERIPHERAL_PREF_MIN_INT=12
CONFIG_BT_PERIPHERAL_PREF_MAX_INT=24
CONFIG_BT_PERIPHERAL_PREF_LATENCY=0
CONFIG_BT_PERIPHERAL_PREF_TIMEOUT=200

# L2CAP CoC carries the Aliro transaction. 512-byte SDUs match the ESP port.
CONFIG_BT_L2CAP_DYNAMIC_CHANNEL=y
CONFIG_BT_L2CAP_TX_MTU=512
# Sized for a PDU, not an SDU. The host's HCI receive pool is UNIFIED and gives
# every buffer the largest of the ACL and event sizes (buf.h:165, buf.h:175), so
# a 527 B ACL buffer made all twelve cost 527 B: 6,384 B measured in .bss for a
# geometry only one of them needed. Nothing here reassembles into that pool --
# coc_alloc_buf() hands the host an s_coc_rx_pool buffer of its own and Zephyr
# builds the SDU there. At 255 the MPS falls to ~251, a 512 B SDU rides three
# PDUs instead of one, and the pool costs 3,060 B. The price is two extra
# connection events per Aliro APDU, which is nothing against a walk-up. BTP is
# untouched: it rides GATT at an ATT MTU of 247, which still fits one PDU.
CONFIG_BT_BUF_ACL_RX_SIZE=255
CONFIG_BT_BUF_ACL_TX_SIZE=251
# NOT raised, and worth a line so it is not tried again. CONFIG_BT_BUF_EVT_RX_SIZE
# cannot change what the controller checks: hci_driver.c compares against
# HCI_RX_BUF_SIZE = BT_BUF_RX_SIZE = MAX(ACL_RX_SIZE + 4, EVT_RX_SIZE + 2), which
# the 255 above already fixes at 259. Measured: raising it to 255 moved nothing
# and cost 752 B of RAM, a quarter of what this image has left.
CONFIG_BT_EATT=n

# ---- crypto -----------------------------------------------------------------
# nRF52833 has no CryptoCell, so PSA lands on the software nrf_oberon backend.
# That is a speed and flash cost, not a blocker. Same PSA_WANT set the nRF5340
# on-target EC self-test proved (ports/nrf5340dk/on_target_ec/prj.conf).
CONFIG_NRF_SECURITY=y
CONFIG_MBEDTLS_PSA_CRYPTO_C=y
CONFIG_MBEDTLS_ENABLE_HEAP=y
# MEASURED, not argued. 16384 was a guess carried from the ESP port and it was
# the largest single object in .bss. With ALIRO_HEAP_PROBE the peak across boot,
# PASE and a full CASE handshake is 228 B in 11 blocks -- reproduced on two
# independent runs, the second on a fully erased board with a new SRP key and a
# new node id. The Kconfig help for ALIRO_HEAP_PROBE predicted this: the build
# is OBERON_ONLY_PSA_ENABLED with no MBEDTLS_BIGNUM_C or ECP_C, so ECDH and
# ECDSA run in driver stack buffers and only PSA key-slot material is ever
# mbedtls_calloc'd.
#
# 1024 kept 4.5x the measured peak, and it was not a fresh guess: the reader
# build was rebuilt at exactly that value and a live iPhone still unlocked, on a
# fresh session, for a saving of 15,360 B. CASE's own peak is 380 B, measured by
# ALIRO_CASE_BENCH, so 1024 covered both users of this heap with room over.
#
# This line used to carry a caution -- "NOT cut to peak+2048: the one path this
# image cannot exercise is an Aliro unlock, because a Matter build carries no
# reader identity". That premise expired on 2026-08-02, when Apple Home began
# provisioning the reader itself and this image started doing full walk-up
# unlocks. The path the caution was about is now exercised by the very walk-up
# that validates every other RAM change, which is what makes the cut checkable
# rather than merely argued.
#
# 512 WAS TRIED ON 2026-08-03 AND BROKE MATTER OVER THREAD. Do not try it again
# without reading this, because the argument for it looks airtight and the
# failure lands nowhere near the heap.
#
# The 228 B peak above is real and was never wrong. What it does not cover is
# the one allocation this image makes rarely and cannot do without: creating a
# PERSISTENT PSA key. OpenThread's SRP client does exactly that -- this build
# has OPENTHREAD_CONFIG_PLATFORM_KEY_REFERENCES_ENABLE=1, so its ECDSA key is
# generated at PSA_KEY_LIFETIME_PERSISTENT (crypto_psa.c:591), which serialises
# the key, seals it with ChaCha20-Poly1305 and writes it through
# trusted_storage. None of that runs on the boot, PASE or CASE paths the 228 B
# was measured across, and none of it runs for a volatile key.
#
# MEASURED by srp_sign_self_test() in matter_commission.c: at 512 a volatile
# P-256 deterministic-ECDSA key generates, exports, imports and signs perfectly,
# and the identical sequence at persistent lifetime fails inside psa_generate_key
# with psa_status=-141, PSA_ERROR_INSUFFICIENT_MEMORY. Two log lines apart, same
# boot.
#
# WHAT IT LOOKS LIKE WHEN IT BREAKS, because it looks like anything but this.
# The board commissions over BLE, completes PASE, accepts AddNOC, attaches to
# Thread as a child and gets an off-mesh address -- and then never registers its
# name. OpenThread reports one value for it, kErrorFailed, which
# crypto_psa.c:22-34 maps every PSA error onto except two, and which
# dns_types.cpp:52-100 ALSO produces from a server SERVFAIL. So the log says
# "SRP registration FAILED (1) -- the commissioner cannot resolve this node",
# every finger points at the border router, and an afternoon goes into the
# network before anyone suspects a RAM constant.
CONFIG_MBEDTLS_HEAP_SIZE=1024

# PSA PERSISTENT-KEY STORAGE MUST STAY ON. Do not cut it, and here is the
# receipt, because the argument for cutting it is convincing and wrong.
#
# The argument: this image's PSA_WANT list above names no ChaCha, yet the build
# links a whole ChaCha20-Poly1305 -- MEASURED from the map, ocrypto_chacha20
# 874 B + ocrypto_poly1305 1,250 B + ocrypto_chacha20_poly1305 762 B = 2,886 B,
# before the ITS glue on top. It arrives because MBEDTLS_PSA_CRYPTO_STORAGE_C
# pulls in TRUSTED_STORAGE, whose AEAD backend has exactly one cipher choice
# (nrf/subsys/trusted_storage/Kconfig:84-98, no AES-GCM alternative to switch
# to). And nothing in modules/ or firmware/src calls psa_set_key_id() or asks
# for PSA_KEY_LIFETIME_PERSISTENT: the reader identity and the Matter fabrics
# are settings-store data owned by aliro_prov_settings.c and
# matter_fab_settings.c, not by PSA. Total saving, measured: 6,480 B of flash.
#
# Why it is wrong: OPENTHREAD_CRYPTO_PSA=y, so OpenThread's own platform glue
# is the caller this tree cannot see. zephyr/modules/openthread/platform/
# crypto_psa.c:180 imports keys at PSA_KEY_LIFETIME_PERSISTENT, and :591
# generates the SRP ECDSA key that way UNCONDITIONALLY. With the storage gone
# they cannot succeed, and the node cannot hold a network key. Which
# psa_status_t comes back was NOT measured -- the failure below logs no status
# at all -- so do not quote one; the call sites are the evidence.
#
# The failure does not look like a crypto failure. MEASURED 2026-08-03: PASE
# completed, AddNOC returned status 0, the 107 B dataset was accepted, and then
# "Thread still detached after 20000 ms" with the commissioner giving up on the
# BLE link 18 s in. Nothing logged an error, because every layer that could
# have was upstream of the one that failed.
#
# Grep workspace/ before calling a PSA lifetime unused here. The tracked tree is
# not the whole caller set, and this cost a commissioning round to learn.

CONFIG_PSA_WANT_ALG_ECDSA=y
CONFIG_PSA_WANT_ALG_ECDH=y
CONFIG_PSA_WANT_KEY_TYPE_ECC_KEY_PAIR_GENERATE=y
CONFIG_PSA_WANT_KEY_TYPE_ECC_KEY_PAIR_IMPORT=y
CONFIG_PSA_WANT_KEY_TYPE_ECC_KEY_PAIR_EXPORT=y
CONFIG_PSA_WANT_KEY_TYPE_ECC_KEY_PAIR_DERIVE=y
CONFIG_PSA_WANT_KEY_TYPE_ECC_PUBLIC_KEY=y
CONFIG_PSA_WANT_ECC_SECP_R1_256=y
CONFIG_PSA_WANT_ALG_SHA_256=y
# No PSA_WANT_ALG_HKDF here on purpose. It depends on PSA_WANT_ALG_HMAC, which
# this image does not enable, so assigning it only produced a Kconfig warning
# and the value n -- psa_key_derivation_setup() returns PSA_ERROR_NOT_SUPPORTED.
# Nothing missed it: key derivation goes through aliro_hkdf()
# (modules/woz_aliro/src/aliro_hash.c), pure C11 and already linked. Turning the
# PSA one on would cost flash for a second implementation of RFC 5869.
CONFIG_PSA_WANT_ALG_CMAC=y
CONFIG_PSA_WANT_ALG_ECB_NO_PADDING=y
CONFIG_PSA_WANT_ALG_GCM=y
CONFIG_PSA_WANT_KEY_TYPE_AES=y
CONFIG_PSA_WANT_GENERATE_RANDOM=y

# ---- UWB: CCC/FiRa responder on the module's own DW3110 ---------------------
CONFIG_SPI=y
# ports/zephyr/dw3000/dw3000_spi.c uses spi_transceive_signal (the async API),
# same as the nRF5340 build does via scripts/build-nrf5340dk.sh.
CONFIG_SPI_ASYNC=y
CONFIG_DW3000=y
CONFIG_DW3000_CHIP_DW3000=y
CONFIG_WOZ_UWB=y
CONFIG_WOZ_UWB_RESPONDER=y
# Single-core SoC: BLE shares the core with the ranging callbacks, so the live
# DS-TWR timestamps get overwritten before Final_Data is processed (km-scale
# garbage). Use the same-round snapshot latched at Final RX, like the ESP path.
CONFIG_WOZ_UWB_FINAL_SNAPSHOT=y
CONFIG_WOZ_ALIRO=y
CONFIG_WOZ_CRYPTO_PSA=y

# ---- provisioning / trust store ---------------------------------------------
# CONFIG_MPSL_TIMESLOT_SESSION_COUNT is deliberately NOT set here, and it was
# set for a while by mistake. Flash writes do go through an MPSL timeslot on this
# board (SOC_FLASH_NRF_RADIO_SYNC_MPSL), but the driver brings its OWN session:
# mpsl_init.c:205 initialises MPSL with CONFIG_MPSL_TIMESLOT_SESSION_COUNT PLUS
# CONFIG_SOC_FLASH_NRF_RADIO_SYNC_MPSL_TIMESLOT_SESSION_COUNT, and the latter
# already defaults to 1 whenever flash sync is on. Adding one here buys a second
# session context nothing opens.
CONFIG_FLASH=y
CONFIG_FLASH_MAP=y
CONFIG_NVS=y
CONFIG_SETTINGS=y
CONFIG_SETTINGS_NVS=y

# ---- provisioning console (USB CDC-ACM, provisioning mode only) --------------
# The reader identity is per-device data in the settings store, so it has to be
# typed in at runtime. RTT is output-only and the J-Link VCOM belongs to the
# probe, so the input path is the second USB port, which is wired straight to
# the nRF52833. main() calls usb_enable() ONLY when SW2 is held through reset,
# so an operational boot pays the flash for this but never runs a USB interrupt
# next to the DW3110's delayed-TX window.
CONFIG_GPIO=y
CONFIG_SERIAL=y
CONFIG_USB_DEVICE_INITIALIZE_AT_BOOT=n
# The shell and USB sizes that this console needs live in Kconfig under
# CONFIG_ALIRO_PROV_CONSOLE, with the measurement behind each one. They cannot
# sit here: a .conf assignment is unconditional, so a build that turns the
# console off (a Matter node self-provisions, and reader + console + Thread
# overflows RAM by 1,752 B anyway) would leave them unsatisfiable and NCS aborts
# on the Kconfig warning.
# Logs stay on RTT. CONFIG_LOG_MODE_MINIMAL writes straight to the console and
# does not drive backends, so a shell log backend would cost RAM and deliver
# nothing.
CONFIG_SHELL_LOG_BACKEND=n
CONFIG_SHELL_HISTORY=n
# The `aliro` command tree here is provisioning only (firmware/src/
# prov_shell.c). woz_uwb's console of the same name drives a radio that
# provisioning mode never starts.
CONFIG_WOZ_UWB_SHELL=n

# ---- what is deliberately absent --------------------------------------------
# Console stays on, but over RTT rather than UART (see logging below).
CONFIG_UART_CONSOLE=n
# MCUboot IS built, and this file no longer decides that: sysbuild.conf does,
# through SB_CONFIG_BOOTLOADER_MCUBOOT. Sysbuild pushes the answer down onto
# this image itself (zephyr/share/sysbuild/image_configurations/
# MAIN_image_default.cmake:8 calls set_config_bool on CONFIG_BOOTLOADER_MCUBOOT),
# and that assignment is applied AFTER prj.conf -- so a `=n` here would not win,
# it would just make this file lie about the image it describes.
#
# What it used to say, kept because the mechanism is still true and still the
# thing that surprises people: CONFIG_BOOTLOADER_MCUBOOT is what produces the
# flash map, not the DTS. With it off, Partition Manager gave `app`
# 0x0..0x7e000 (504 KB) and ignored the 224 KB dual-slot layout in the board
# DTS entirely. With it on, PM builds a bootloader map instead -- and because
# `app` no longer starts at 0 and must not swallow settings_storage, the map is
# now PINNED in pm_static.yml rather than derived. See that file for the sizes
# and boards/decawave_dwm3001cdk.overlay for why the DTS partition nodes remain
# inert either way.
#
# The application still has no SMP server: recovery lives in the bootloader,
# reachable at boot over the J-Link VCOM, and an operational image that also
# spoke mcumgr would be a second write path into its own flash for no gain.
CONFIG_MCUMGR=n

# ---- logging ----------------------------------------------------------------
# RTT, not UART: the delayed-TX reply window on this single-core part cannot
# afford a blocking console write. Minimal mode drops the deferred-logging
# machinery, which is the part that actually costs flash.
CONFIG_LOG=y
CONFIG_LOG_MODE_MINIMAL=y
CONFIG_LOG_DEFAULT_LEVEL=3
CONFIG_USE_SEGGER_RTT=y
CONFIG_RTT_CONSOLE=y
# 8 KB up-buffer, not the 1 KB default. RTT is this board's ONLY console, and
# the default policy is NO_BLOCK_SKIP: once the buffer fills, writes are
# silently DISCARDED. Boot output here exceeds 1 KB, so the default truncates
# mid-line and looks exactly like a hang -- it cost a debugging detour to learn.
# Deliberately not BLOCK_IF_FIFO_FULL: that never drops a byte, but it stalls
# the firmware forever when no debugger is draining the buffer.
CONFIG_SEGGER_RTT_BUFFER_SIZE_UP=8192
# Re-initialize the RTT control block unconditionally. The default here is
# STRONG_CHECK -- and it is the default precisely BECAUSE the RTT data sits in
# a custom section (zephyr/modules/segger/Kconfig:120), whose whole purpose is
# to "avoid re-init of Control Block if another program (e.g. bootloader) has
# already initialized it". That assumes a cooperative bootloader. Ours is not
# one: MCUboot here has no LOG, no PRINTK and no USE_SEGGER_RTT, so it never
# initializes RTT -- it just uses that RAM as ordinary BSS and stack.
#
# And it is the SAME RAM. segger_rtt.ld places the section (NOLOAD) sorted to
# RAM start, so the ring lands at 0x20000010 and the control block at
# 0x20002010, while MCUboot's own _image_ram_end is 0x200049c0. The bootloader
# spans both. Without this line the application finds a control block it
# declines to touch and streams MCUboot's leftover RAM to the console as
# binary garbage interleaved with real log lines.
#
# The cost is that the ring no longer survives a reset. That was already gone:
# MCUboot overwrites it on every boot, before this image runs at all.
CONFIG_SEGGER_RTT_INIT_MODE_ALWAYS=y

CONFIG_MAIN_STACK_SIZE=4096
CONFIG_SYSTEM_WORKQUEUE_STACK_SIZE=4096
CONFIG_HEAP_MEM_POOL_SIZE=4096
```

## overlay-anchor.conf
```kconfig
# Two-anchor geometry on the door node. Stage B/E of internal/two-anchor-plan.md.
#
#   make build ANCHOR=1 CDK_BUILD=build/cdk-anchor
#
# Use ANCHOR=1 and not a hand-written CDK_CONF. CDK_CONF is the WHOLE overlay
# list, so setting it by hand drops whatever you forgot to repeat -- and the one
# most easily forgotten is overlay-lto.conf, which is worth about 41 KB of
# flash. It fails as a 39 KB regression attributed to whatever you were
# measuring, with no warning anywhere. Measured here the first time round.
#
# NOT in the default build, and that is the point: the shipping image stays
# byte-identical until someone decides to pay for this. Every symbol below is
# default n.
#
# What it buys: the second anchor's verdict gates UNLOCK_PREDICT (and only
# PREDICT), plus an impact/tamper interrupt from the accelerometer that is
# already linked into the image and currently does nothing.
#
# What it costs: measure it. `make cdk-size-check CDK_BUILD=build/cdk-anchor`
# against a build without this file is the only number worth quoting, because
# the CDK Matter image is the one where a new static allocation is a decision
# rather than a detail.
#
# Nothing feeds the satellite verdict yet -- Stage C owns the transport -- and
# that is a working state: with no report the verdict is UNKNOWN, UNKNOWN
# permits prediction, and the door behaves exactly as it does today.

CONFIG_WOZ_ANCHOR=y
CONFIG_WOZ_ANCHOR_SLAM=y

# Placeholders, all of them. The baseline is a tape-measure fact about where the
# two boards ended up; the tolerance and dead band come from the ranging jitter
# stage A actually measures, not from the target it aims at; and the impact
# threshold has to come from a capture of this door being closed and slammed.
CONFIG_WOZ_ANCHOR_BASELINE_MM=1200
CONFIG_WOZ_ANCHOR_TOL_MM=90
CONFIG_WOZ_ANCHOR_DEADBAND_MM=60
CONFIG_WOZ_ANCHOR_STALE_MS=1500
CONFIG_WOZ_ANCHOR_SELF_INSIDE=y
CONFIG_WOZ_ANCHOR_SLAM_THRESHOLD_MG=2000
```

## overlay-lto.conf
```kconfig
# Link-time optimisation for the Matter over Thread image.
#
# APPLIED BY DEFAULT to both the debug and the release variant. To build without
# it:
#   make build LTO=0
#
# BOTH LINES ARE REQUIRED, and this is the trap worth knowing. `CONFIG_LTO=y` on
# its own is a silent no-op: the symbol depends on
#   !(GEN_ISR_TABLES || GEN_IRQ_VECTOR_TABLE) || ISR_TABLES_LOCAL_DECLARATION
# (zephyr/Kconfig.zephyr:526-528). With that dependency unmet Kconfig does not
# merely leave LTO off, it drops the symbol from the generated .config entirely,
# and emits no warning while doing it. Never trust a size number from this
# overlay without grepping build/<dir>/firmware/zephyr/.config for BOTH symbols.
#
# WHY IT WAS GATED, and what cleared the gate. LTO is whole-program codegen on
# an image whose UWB ranging path has a ~1836 us arm deadline, and a smaller
# binary is no evidence whatever that the deadline still holds. The only check
# that could prove it is a walk-up unlock on hardware.
#
# That ran 2026-08-02 on the debug image (405,296 B flash, 123,752 B RAM): two
# grants, a relock at 336 cm once past the 250 cm departure gate, a re-grant on
# the return leg at 45 cm, and 604 RX with the STS live throughout. Distance
# tracked unbroken from 1 cm to 584 cm and back. Re-run that walk-up after any
# change that could move the ranging path, not just after changes to this file.
CONFIG_LTO=y
CONFIG_ISR_TABLES_LOCAL_DECLARATION=y
```

## overlay-otlog.conf
```kconfig
# OpenThread's own logging, for diagnosing what the mesh refuses to do.
#
#   make build OTLOG=1 CDK_BUILD=build/cdk-otlog
#
# NEVER SHIP THIS. It is here because OpenThread's log level is 0 in every other
# configuration, and 0 is not a choice this tree made: the level Kconfig sits
# behind `depends on OPENTHREAD_DEBUG` (zephyr/modules/openthread/Kconfig:66-68),
# so with debug off the symbol falls through every default and lands on 0. The
# stack is silent by construction, and no amount of CONFIG_LOG_DEFAULT_LEVEL
# changes that.
#
# WHAT IT BOUGHT, on the first run. Not what this file originally predicted: it
# expected to catch the SRP server's verdict on a registration the application
# could only see as one undifferentiated otError. There was no verdict, because
# there was no registration. MEASURED 2026-08-03, three minutes attached:
#
#   [I] SrpClient-----: HostInfo Removed -> ToAdd
#   [I] SrpClient-----: Service Removed -> ToAdd, "..." "_matter._tcp"   (x2)
#
# and then nothing for the rest of the log. No "Rejected", and -- the line that
# actually answers it -- no "SrpClientInfo {Server:[...]}" at all, so the client
# never chose a server to send to. Both services sat at ToAdd forever while the
# node was a healthy attached child: OMR address configured, Matter subscriptions
# restored over the reboot, and a walk-up Aliro unlock completing end to end.
#
# The boot-time "NO off-mesh-routable address" warning is NOT that failure. It
# fires 9 ms after Thread start with the role still detached, and the same run
# later carries Matter traffic on the border router's prefix.
#
# So the question moved, and CONFIG_ALIRO_SRP_DIAG below is where it moved to:
# whether auto-start is ever offered a server at all. The OpenThread lines are
# still what makes that readable -- they are the proof network data arrived.
#
# LOG_MODE_MINIMAL HAS TO GO, and that is a link error rather than a choice.
# otPlatLog (zephyr/modules/openthread/platform/logging.c:38) forwards through
# log_generic(), the runtime vararg API, and minimal mode does not implement it:
#
#   otPlatLog.constprop.0: undefined reference to `z_log_msg_runtime_vcreate'
#
# So OpenThread's logging and CONFIG_LOG_MODE_MINIMAL cannot both be on. That is
# the real reason this stack has been silent, not the level alone.
#
# CONFIG_LOG_DEFAULT_LEVEL MUST STAY AT 3. logging.c registers no log module of
# its own, so these lines arrive under the default module and the default level
# filters them. Turning the app's own logging down to save room takes the very
# lines this overlay exists to print.
#
# COSTS FLASH, AND IT FITS -- barely. MEASURED 2026-08-03 against the 433,664 B
# app partition: 423,636 B, 97.69%, 10,028 B free, everything in this file
# included. The default build is 409,988 B / 94.54%, so this overlay costs
# 13,648 B. That is most of the free partition for a build that exists to answer
# one question, which is the other reason this never ships. An overflow fails
# the link, which is the right failure -- nothing ships and nothing is flashed.
#
# DO NOT SET CONFIG_OPENTHREAD_PLATFORM_LOG_LEVEL. otPlatLog gates on it
# (logging.c:46) so it looks like the knob, but Kconfig:100 declares it as an
# int with no prompt, derived from the level choice below -- INFO gives it 3 on
# its own. Assigning it aborts the CMake configure rather than warning.
CONFIG_LOG_MODE_MINIMAL=n
CONFIG_LOG_MODE_IMMEDIATE=y
CONFIG_OPENTHREAD_DEBUG=y
CONFIG_OPENTHREAD_LOG_LEVEL_INFO=y

# ROOM FOR THE ABOVE. The first build that linked overflowed FLASH by 1,120 B,
# so three modules give up their INF and WRN strings. None of them can touch the
# question this overlay asks: the SRP client is inside OpenThread and reaches
# the console through otPlatLog, not through any of these.
#
# The app's own errors survive -- LOG_ERR is still compiled in, which is the
# level "SRP registration FAILED" is logged at. What is lost is the INF
# narration around it ("Thread attached", "reachable"), and OpenThread's own
# logging is more than dense enough to place events in time without it.
#
# Every symbol here was read out of a generated .config first. A module log
# level that does not exist is not a warning, it aborts the CMake configure --
# the same way CONFIG_OPENTHREAD_PLATFORM_LOG_LEVEL did above.
CONFIG_BT_LOG_LEVEL_ERR=y
CONFIG_WOZ_DFU_LOG_LEVEL_ERR=y
CONFIG_WOZ_ALIRO_LOG_LEVEL_ERR=y

# THE QUESTION THIS OVERLAY NOW ASKS. The first run with OpenThread's logging on
# showed no server rejection at all -- no rejection, and no server. See
# CONFIG_ALIRO_SRP_DIAG in firmware/Kconfig for what it prints and why network
# data changing is the only moment worth printing it. Lives here rather than in
# a second overlay because it is unreadable without the OpenThread lines around
# it: they are what proves network data arrived at all.
#
# matter_thread is deliberately NOT trimmed above, so its INF and WRN survive.
CONFIG_ALIRO_SRP_DIAG=y
```

## overlay-release.conf
```kconfig
# Release profile for the Matter over Thread image.
#
# Build with:
#   make build RELEASE=1
#
# Everything here buys RAM or boot time by giving up ON-BOARD DEBUGGING, so do
# not flash it to a board you are still bringing up. The debug default is what
# every measurement in internal/cdk-size-baseline.md was taken against, and it
# stays the default precisely because this port is still being debugged.

# The RTT up-buffer is 8,376 B of RAM in a section of its own -- bigger than any
# single thread stack, and on the debug image bigger than the entire free
# margin. 8192 is load-bearing WHILE DEBUGGING: at 4096 the ring filled
# mid-ranging and NO_BLOCK_SKIP silently dropped the grant line, which cost a
# walk-up to diagnose. That is exactly why the ring is given up HERE and nowhere
# else. A release board has no debugger draining it, so the ring only has to
# hold enough to be worth reading if someone attaches after a fault.
#
# Consequence to accept knowingly: with 1 KB the boot log alone truncates, and
# under NO_BLOCK_SKIP it is the NEWEST writes that are discarded. On this image
# a fault therefore looks like a hang. If you are diagnosing anything, drop
# RELEASE=1 rather than raising this number here.
CONFIG_SEGGER_RTT_BUFFER_SIZE_UP=1024

# Stack painting costs no RAM -- it fills the stacks that already exist -- but it
# costs boot time on every one of the 13 of them, and it exists to be read by a
# debugger that a release board does not have. Kept ON in the debug default,
# where CONFIG_OPENTHREAD_THREAD_STACK_SIZE and CONFIG_SYSTEM_WORKQUEUE_STACK_SIZE
# are still being sized from the 0xAA runs.
CONFIG_INIT_STACKS=n

# Errors only. This is the single largest flash lever on the image and it was
# hiding behind the RAM story: the release profile already gave up the 8 KB RTT
# RING above, but every wrn/inf/dbg FORMAT STRING was still linked into rodata
# for a board with a 1 KB ring that nobody is draining.
#
# MEASURED on this overlay, 2026-08-04, SMP=1 RELEASE=1, app partition only:
#
#   baseline (LOG_DEFAULT_LEVEL=3)   417,308 B   96.23%    16,356 B free
#   LOG_DEFAULT_LEVEL=1              396,740 B   91.49%    36,924 B free
#   CONFIG_LOG=n                     374,796 B   86.43%    58,868 B free
#
# So dropping to errors is worth 20,568 B and dropping logging entirely is
# worth 42,512 B. Level 1 is what is set here, deliberately: the extra 21,944 B
# is real but it buys nothing you can currently spend, and it costs the only
# post-fault evidence this board can produce. RAM moves by 192 B either way --
# this lever is flash, not RAM, which is why it never showed up in the RAM
# inventory in internal/cdk-size-baseline.md.
#
# If a future feature needs that last 21,944 B, CONFIG_LOG=n is measured and
# ready. Do not take it speculatively.
CONFIG_LOG_DEFAULT_LEVEL=1
```

## overlay-smp.conf
```kconfig
# SMP over Bluetooth, so a phone can push an update with off-the-shelf tooling.
#
#   make build SMP=1 RELEASE=1 && make flash                  # what ships
#   make build SMP=1 PRISTINE=1 && make flash                 # debug; PRISTINE=1 needed when switching from RELEASE=1
#
# WHAT THIS BUYS. nRF Device Manager and nRF Connect for iOS speak mcumgr and
# nothing else. With this overlay the board answers them, and an update needs no
# Mac, no Python and no cable: Images -> Upload the .woz patch, then Device ->
# Reset. The native L2CAP channel (src/dfu_ble_zephyr.c) stays exactly as it
# was, so `make dfu` is unaffected and either route works.
#
# RELEASE=1 USED TO BE EFFECTIVELY REQUIRED. It is not any more, and the reason
# is worth reading before you reach for it out of habit.
#
# What this file said, measured at the time and correct then:
#
#     debug   + SMP    128,660 B of 131,072   98.16%     2,412 B free
#     release + SMP    121,492 B of 131,072   92.69%     9,580 B free
#
# 2,412 B is not enough to absorb a connection event on a board also running
# Thread, Matter and UWB, so RELEASE=1 was the only way to fit -- and since its
# cost is the 8 KB RTT ring, that made SMP the configuration you could not debug
# over SWD. "Keep a debug build to hand before flashing it" was the workaround.
#
# MEASURED AGAIN 2026-08-04, after standalone OpenThread retired the Zephyr IP
# layer (see overlay-thread.conf) and errors-only logging landed in
# overlay-release.conf:
#
#     debug   + SMP    118,308 B of 131,072   90.26%    12,764 B free
#     release + SMP    111,012 B of 131,072   84.70%    20,060 B free
#
# A DEBUG SMP IMAGE NOW HAS MORE RAM FREE THAN THE SHIPPING IMAGE DID. 12,764 B
# against the 9,580 B that release+SMP had to be built for. So `make build SMP=1`
# with no RELEASE=1 is a real configuration now: mcumgr, the full 8 KB ring and
# level-3 logging at once. That is the build to reach for when something fails
# during commissioning, because at RELEASE=1's log level 1 a stall at "Adding to
# Home" says nothing at all.
#
# RELEASE=1 is still what ships. It is no longer what makes this fit.
#
# WHAT IS NOT ENABLED, and cannot be. Zephyr's own image group:
#
#     CONFIG_MCUMGR_GRP_IMG ... was assigned the value 'y' but got 'n'.
#     Check these unsatisfied dependencies:
#         IMG_MANAGER (=n), (!MCUBOOT_BOOTLOADER_MODE_SINGLE_APP) (=n)
#
# img_mgmt is gated off by single-slot mode ITSELF, not by a missing partition,
# so no renaming of patch_staging reaches it. Single-slot mode is what makes
# MCUboot fit in a 512 KB part. ports/zephyr/dfu/dfu_smp_img.c therefore
# serves group 1 directly, forwarding every byte into the same receiver, the
# same signature check and the same window gate as the native transport.

CONFIG_ZCBOR=y
CONFIG_MCUMGR=y
CONFIG_MCUMGR_TRANSPORT_BT=y

# THE SECURITY COST OF THIS LINE, stated plainly. The permission choice defaults
# to _RW_AUTHEN whenever BT_SMP is on, which demands a paired link -- and this
# reader must never ask a phone to pair, because pairing is not how an Aliro
# credential authorises anything. _RW removes the prompt and leaves the SMP
# endpoint writable by any unpaired peer in radio range.
#
# What stands in front of it is the update window, and only that: uploads and
# erases are refused with ACCESS_DENIED until the owner presses SW2 or Apple
# Home opens a commissioning window. Behind it, the patch is signed and MCUboot
# re-verifies the result, so no peer can install code either way.
#
# If you do not need phone tooling, leave this overlay off. The native L2CAP
# channel gates on the same window and needs no world-writable endpoint.
CONFIG_MCUMGR_TRANSPORT_BT_PERM_RW=y

# Big enough that a 400+ B upload chunk arrives in one buffer, small enough that
# two of them are 1 KB. Count 2 is the minimum that lets a response be built
# while the next request is being reassembled.
CONFIG_MCUMGR_TRANSPORT_NETBUF_SIZE=512
CONFIG_MCUMGR_TRANSPORT_NETBUF_COUNT=2
CONFIG_MCUMGR_TRANSPORT_WORKQUEUE_STACK_SIZE=2048

# Group 1, ours. Group 0 for the reset that starts the bootloader applying.
CONFIG_WOZ_DFU_SMP_IMG=y
CONFIG_MCUMGR_GRP_OS=y

# THE RESET GATE, and it is load-bearing. Group 0 command 5 reboots the board,
# and with _RW above it is reachable by any unpaired peer in radio range -- a
# reboot loop on a door lock, needing no credential and no pairing. The hook
# lets dfu_smp_img.c refuse a reset unless the owner opened an update window or
# a verified patch is already staged. Turning either symbol off silently
# reopens that hole, because the handler simply stops being called.
CONFIG_MCUMGR_MGMT_NOTIFICATION_HOOKS=y
CONFIG_MCUMGR_GRP_OS_RESET_HOOK=y

# Everything else off. Each of these is an endpoint an unpaired peer could
# reach, and none is needed to move a patch: taskstat and info leak the
# firmware's internals, and fs/settings/shell would expose the reader identity
# and the Matter fabrics that live in settings_storage.
CONFIG_MCUMGR_GRP_OS_TASKSTAT=n
CONFIG_MCUMGR_GRP_OS_INFO=n
CONFIG_MCUMGR_GRP_OS_BOOTLOADER_INFO=n
CONFIG_MCUMGR_GRP_SHELL=n
CONFIG_MCUMGR_GRP_STAT=n
CONFIG_MCUMGR_GRP_FS=n
CONFIG_MCUMGR_GRP_SETTINGS=n
```

## src/aliro_prov_settings.c
```c
/*
 * aliro_prov (Zephyr settings backend) — the DWM3001CDK twin of the ESP32
 * port's aliro_prov_nvs.c. The portable serialisation, dev fallback and trust
 * logic all live in aliro_prov.c; this file only moves that one blob in and out
 * of the settings store on `storage_partition`.
 */
#include <string.h>

#include <zephyr/logging/log.h>
#include <zephyr/settings/settings.h>

#include "aliro_prov.h"

LOG_MODULE_REGISTER(aliro_prov, CONFIG_LOG_DEFAULT_LEVEL);

#define ALIRO_PROV_KEY "aliro/prov"

static uint8_t s_blob[ALIRO_PROV_BLOB_MAX];
static size_t s_blob_len;

/**
 * Settings callback to deserialize and store a provisioning blob read from persistent storage.
 * Validates that the blob does not exceed s_blob size and returns -EINVAL on overflow or read
 * error; on success stores the blob length and returns 0.
 */
static int prov_set(const char *name, size_t len, settings_read_cb read_cb, void *cb_arg)
{
	ARG_UNUSED(name);

	if (len > sizeof(s_blob)) {
		return -EINVAL;
	}

	ssize_t got = read_cb(cb_arg, s_blob, len);

	if (got < 0) {
		return (int)got;
	}
	s_blob_len = (size_t)got;
	return 0;
}

SETTINGS_STATIC_HANDLER_DEFINE(aliro_prov, "aliro", NULL, prov_set, NULL, NULL);

/**
 * Load Aliro reader identity and trust anchors from persistent settings. Returns 0 on success with
 * stored data loaded, 1 if never provisioned (DEV identity used), -1 on any error (settings init,
 * load, or malformed blob; DEV identity used). On any failure the loaded identity defaults to DEV
 * and the error is logged as a warning.
 */
int aliro_prov_load(struct aliro_reader_identity *id, struct aliro_trust_store *ts)
{
	int rc = settings_subsys_init();

	if (rc != 0) {
		LOG_WRN("settings init rc=%d; using DEV identity", rc);
		aliro_prov_dev_default(id, ts);
		return -1;
	}

#if IS_ENABLED(CONFIG_ALIRO_PROV_CLEAR_ON_BOOT)
	/* Before the load, not after: the point is that nothing ever sees the old
	 * blob, so the identity this boot reports is the DEV one. */
	rc = settings_delete(ALIRO_PROV_KEY);
	LOG_WRN("clear-on-boot: erased " ALIRO_PROV_KEY " (rc=%d)", rc);
#endif

	s_blob_len = 0;
	rc = settings_load_subtree("aliro");
	if (rc != 0) {
		LOG_WRN("settings load rc=%d; using DEV identity", rc);
		aliro_prov_dev_default(id, ts);
		return -1;
	}

	if (s_blob_len == 0) {
		/* Never provisioned. */
		aliro_prov_dev_default(id, ts);
		return 1;
	}

	if (aliro_prov_deserialize(s_blob, s_blob_len, id, ts) != 0) {
		LOG_WRN("stored blob malformed; using DEV identity");
		aliro_prov_dev_default(id, ts);
		return -1;
	}
	return 0;
}

/**
 * Erase the stored Aliro provisioning blob from persistent settings. Returns 0 on success, negative
 * on settings error; the error is logged as a warning and returned rather than suppressed, because
 * a silent factory reset that left the old anchors in place would pair but then reject the phone.
 */
int aliro_prov_erase(void)
{
	int rc = settings_subsys_init();

	if (rc != 0) {
		LOG_ERR("settings init rc=%d; nothing erased", rc);
		return rc;
	}
	rc = settings_delete(ALIRO_PROV_KEY);
	/* The rc is reported, not swallowed. A factory reset that quietly did
	 * nothing is worse than one that fails loudly: the board comes back
	 * looking reset, pairs, and then rejects the phone with the old
	 * anchors still in the store. */
	LOG_WRN("factory reset: erased " ALIRO_PROV_KEY " (rc=%d)", rc);
	return rc;
}

/**
 * Serialize and store Aliro reader identity and trust anchors to persistent settings. Uses a static
 * blob buffer to avoid stack overflow; safe because provisioning writes are rare and serialized on
 * s_prov_lock or the Matter work queue. Returns the result of settings_save_one.
 */
int aliro_prov_store(const struct aliro_reader_identity *id, const struct aliro_trust_store *ts)
{
	/*
	 * STATIC, not on the stack. ALIRO_PROV_BLOB_MAX scales with
	 * ALIRO_TRUST_MAX, and raising that 4 -> 8 put this at 864 B on a frame
	 * that also holds a 778 B struct aliro_trust_store. The result was an
	 * MPU fault through the bottom of the 4 KB main stack about four
	 * seconds into boot -- the board advertised, froze, and the phone
	 * reported "transaction timed out" with nothing in the log after the
	 * advert line.
	 *
	 * Safe as static because every caller reaches here from the reader's
	 * provisioning paths, which are serialised on s_prov_lock or run on the
	 * Matter work queue, and provisioning writes are rare besides.
	 */
	static uint8_t blob[ALIRO_PROV_BLOB_MAX];
	size_t len = 0;

	if (aliro_prov_serialize(id, ts, blob, sizeof(blob), &len) != 0) {
		return -EINVAL;
	}
	return settings_save_one(ALIRO_PROV_KEY, blob, len);
}
```

## src/cirdiag_capture.c
```c
/**
 * @file cirdiag_capture.c — unattended CIR capture cycle for the DWM3001CDK.
 *
 * Arm the CIR dump, hold it for a window, disarm so the ring drains, wait,
 * repeat -- forever, from boot. Not a shell command because this board has no
 * console input, and the one button is already the factory reset. The operator
 * watches `make monitor`: each cycle prints `cir.cycle: n=<i>` markers around a
 * labelled interval; walk up from outside during odd cycles, inside during
 * even, and the labelling problem is solved.
 *
 * With CONFIG_ALIRO_CIRDIAG_CAPTURE_WINDOWS the windowed-CIR dump is armed --
 * which on this board stops the responder transmitting entirely (measured: tx0,
 * no range). Without it only the summary path runs (one `[ALAB] ev=uwb.diag`
 * line per reception), and that is the mode worth using: the tap-derived half
 * of the feature set is worth only 0.14 accuracy points. The markers carry no
 * [ALAB] prefix so the parser ignores them.
 */

#include <zephyr/kernel.h>
#include <zephyr/logging/log.h>

#include "uwb_cirdiag.h"
#include "woz_log.h"

LOG_MODULE_DECLARE(main, CONFIG_LOG_DEFAULT_LEVEL);

/**
 * Capture loop: arm the dump, hold it open, disarm to drain the ring, idle, repeat forever.
 * Never returns.
 */
static void cirdiag_capture_thread(void *a, void *b, void *c)
{
	ARG_UNUSED(a);
	ARG_UNUSED(b);
	ARG_UNUSED(c);

	/* Nothing here needs the radio to be up: uwb_cirdiag_set_enabled() and
	 * uwb_cirdiag_dump_set_enabled() are documented safe before the chip is
	 * probed, because the chip-side CIA logging enable happens lazily on the
	 * first armed reception. Waiting for a ranging session would mean knowing
	 * about one, which this file does not. */
#if defined(CONFIG_ALIRO_CIRDIAG_CAPTURE_WINDOWS)
	LOG_WRN("CIR capture image: %d ms armed, %d ms idle. NOT a shipping build.",
		CONFIG_ALIRO_CIRDIAG_CAPTURE_WINDOW_MS, CONFIG_ALIRO_CIRDIAG_CAPTURE_IDLE_MS);

	for (uint32_t n = 1;; n++) {
		woz_printf("cir.cycle: n=%u armed\n", (unsigned)n);
		uwb_cirdiag_dump_set_enabled(true);

		k_msleep(CONFIG_ALIRO_CIRDIAG_CAPTURE_WINDOW_MS);

		/* Read the count before disarming: the disarm IS the drain, and it
		 * empties the ring on its way out. */
		const uint32_t recs = uwb_cirdiag_ring_count();

		uwb_cirdiag_dump_set_enabled(false);
		woz_printf("cir.cycle: n=%u drained recs=%u\n", (unsigned)n, (unsigned)recs);

		k_msleep(CONFIG_ALIRO_CIRDIAG_CAPTURE_IDLE_MS);
	}
#else
	/* Summary only: arm once and leave it. The dump is never armed, so no
	 * accumulator is ever read and the ring stays empty and undrained. Diagnostic
	 * lines therefore keep flowing through the gap as well; the markers are
	 * interval boundaries, not a gate, and a parser keeps what falls between
	 * `capture` and its `end`. */
	LOG_WRN("CIR capture image: SUMMARY ONLY, %d ms per interval. NOT a shipping build.",
		CONFIG_ALIRO_CIRDIAG_CAPTURE_WINDOW_MS);
	uwb_cirdiag_set_enabled(true);

	for (uint32_t n = 1;; n++) {
		woz_printf("cir.cycle: n=%u capture\n", (unsigned)n);
		k_msleep(CONFIG_ALIRO_CIRDIAG_CAPTURE_WINDOW_MS);
		woz_printf("cir.cycle: n=%u end\n", (unsigned)n);
		k_msleep(CONFIG_ALIRO_CIRDIAG_CAPTURE_IDLE_MS);
	}
#endif
}

K_THREAD_DEFINE(cirdiag_capture_tid, CONFIG_ALIRO_CIRDIAG_CAPTURE_STACK, cirdiag_capture_thread,
		NULL, NULL, NULL, CONFIG_ALIRO_CIRDIAG_CAPTURE_PRIO, 0, 0);
```
