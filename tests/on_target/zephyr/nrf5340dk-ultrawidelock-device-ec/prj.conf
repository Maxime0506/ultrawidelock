## CMakeLists.txt
```
# Standalone Zephyr app: run the credential device (initiator) self-test on an
# nRF5340 DK against the real nrf_security/CryptoCell PSA P-256 backend
# (ultrawidelock_prim_psa.c). Console prints PASS/FAIL. No BLE/UWB/iPhone.
cmake_minimum_required(VERSION 3.20.0)
find_package(Zephyr REQUIRED HINTS $ENV{ZEPHYR_BASE})
project(ultrawidelock_device_ec_test)

get_filename_component(REPO_ROOT "${CMAKE_CURRENT_LIST_DIR}/../../../.." ABSOLUTE)
set(CRED "${REPO_ROOT}/modules/ultrawidelock_cred")
# The device self-test body is port-neutral and lives in tests/shared; the
# ESP32 host suite compiles the same file against the fake-EC prim double,
# while this app links it against the real CryptoCell P-256 backend.
set(TESTDIR "${REPO_ROOT}/tests/shared")

# Device-side shared sources by role manifest (modules/ultrawidelock_cred/roles/*.list)
# — the same lists the initiator app and the ESP32 components read.
include("${REPO_ROOT}/cmake/ultrawidelock_roles.cmake")
ultrawidelock_role_sources("${CRED}/roles/device.list" ULTRAWIDELOCK_DEVICE_SRCS)
ultrawidelock_role_sources("${CRED}/roles/apdu.list" ULTRAWIDELOCK_APDU_SRCS)
ultrawidelock_role_sources("${CRED}/roles/crypto.list" ULTRAWIDELOCK_CRYPTO_SRCS)
ultrawidelock_role_sources("${CRED}/roles/hash.list" ULTRAWIDELOCK_HASH_SRCS)

target_sources(app PRIVATE
	src/main.c
	${TESTDIR}/test_ultrawidelock_device.c
	${ULTRAWIDELOCK_DEVICE_SRCS}
	${ULTRAWIDELOCK_APDU_SRCS}
	${ULTRAWIDELOCK_CRYPTO_SRCS}
	${ULTRAWIDELOCK_HASH_SRCS}
)
target_include_directories(app PRIVATE ${CRED}/include ${CRED}/src)
target_compile_definitions(app PRIVATE ULTRAWIDELOCK_DEVICE_HAVE_EC)
```

## prj.conf
```kconfig
# nRF5340 DK: credential device (initiator) EC self-test against the real
# nrf_security/CryptoCell PSA backend. printf goes to the DK's UART console.
CONFIG_MAIN_STACK_SIZE=16384
CONFIG_STDOUT_CONSOLE=y

CONFIG_NRF_SECURITY=y
CONFIG_MBEDTLS_PSA_CRYPTO_C=y

# PSA crypto (Oberon/CC3xx) allocates working buffers from the mbedTLS heap.
# Without it, psa_import_key / AES-GCM / P-256 fail with -141
# (PSA_ERROR_INSUFFICIENT_MEMORY). Sized for the P-256 ECDH/ECDSA loopback.
CONFIG_MBEDTLS_ENABLE_HEAP=y
CONFIG_MBEDTLS_HEAP_SIZE=32768

# The exact primitives ultrawidelock_prim_psa.c calls: P-256 keygen/import/export,
# ECDH raw key agreement, ECDSA(SHA-256) sign/verify, AES-256-GCM (secure
# channels + fast cryptogram), SHA-256 and the RNG.
CONFIG_PSA_WANT_ALG_ECDSA=y
CONFIG_PSA_WANT_ALG_ECDH=y
CONFIG_PSA_WANT_KEY_TYPE_ECC_KEY_PAIR_GENERATE=y
CONFIG_PSA_WANT_KEY_TYPE_ECC_KEY_PAIR_IMPORT=y
CONFIG_PSA_WANT_KEY_TYPE_ECC_KEY_PAIR_EXPORT=y
CONFIG_PSA_WANT_KEY_TYPE_ECC_KEY_PAIR_DERIVE=y
CONFIG_PSA_WANT_KEY_TYPE_ECC_PUBLIC_KEY=y
CONFIG_PSA_WANT_ECC_SECP_R1_256=y
CONFIG_PSA_WANT_ALG_SHA_256=y
CONFIG_PSA_WANT_ALG_GCM=y
CONFIG_PSA_WANT_KEY_TYPE_AES=y
CONFIG_PSA_WANT_GENERATE_RANDOM=y
```

## src/main.c
```c
// nRF5340DK on-target self-test for the credential device (initiator) EC path: a
// minimal Zephyr application that brings up the real PSA backend (nrf_security on
// CryptoCell), runs the same credential-auth crypto suite the host tests run, and
// prints PASS or FAIL to the DK console. It exists because the host suite proves
// the maths against a software curve only; this proves the same vectors on the
// silicon that will ship, and it caught a PSA import failure that no host run
// could see. Crypto only: no BLE, no UWB, no iPhone.
/*
 * nRF5340 entry for the credential device (initiator) EC self-test. Initialises the
 * PSA backend (nrf_security/CryptoCell), runs the same suite as the host test
 * (tests/shared/test_ultrawidelock_device.c) against the real P-256 curve, and
 * prints the verdict to the DK's UART console. Credential-auth crypto only; no
 * BLE, UWB or iPhone.
 */
#include <stdio.h>

#include <zephyr/kernel.h>

#include "ultrawidelock_prim.h"

int ultrawidelock_device_selftest(void);

/**
 * Run the on-target credential device EC self-test: initialize PSA, run the device self-test, and
 * print PASS or FAIL with return code.
 */
int main(void)
{
	printf("\n=== on-target credential device EC self-test (nRF5340, nrf_security PSA) ===\n");

	if (ultrawidelock_prim_init() != 0) {
		printf("\nON-TARGET RESULT: FAIL (PSA init)\n");
		return 0;
	}

	int rc = ultrawidelock_device_selftest();

	printf(rc == 0 ? "\nON-TARGET RESULT: PASS\n" : "\nON-TARGET RESULT: FAIL (rc=%d)\n", rc);
	return 0;
}
```
