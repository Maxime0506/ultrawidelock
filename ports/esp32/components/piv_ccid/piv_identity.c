#include "piv_identity.h"

#include <stdbool.h>
#include <stddef.h>
#include <stdint.h>
#include <string.h>

#include "aliro_prim.h"
#include "nvs.h"
#include "psa/crypto.h"

#include "mbedtls/pk.h"
#include "mbedtls/x509_crt.h"

#include "presence_link.h"

#define PIV_IDENTITY_NS "piv"
#define PIV_IDENTITY_KEY "auth9a"
#define PIV_IDENTITY_MAGIC 0x50495639u
#define PIV_IDENTITY_VERSION 1u
#define PIV_KEY_MANAGEMENT_KEY "key9d"
#define PIV_KEY_MANAGEMENT_MAGIC 0x5049564du
#define PIV_KEY_MANAGEMENT_VERSION 1u
#define PIV_CERT_MAX 768u
#define PIV_PIN_SALT_BYTES 16u
#define PIV_PIN_RETRIES 3u

/**
 * Serialized identity blob holding a private key, public key, certificate, provisioned PIN state,
 * retries, salt, and hash. Magic and version fields used to detect format changes. GUID identifies
 * the identity. Reserved bytes for future use.
 */
struct piv_identity_blob {
	uint32_t magic;
	uint16_t version;
	uint16_t certificate_len;
	uint8_t private_key[ALIRO_P256_SCALAR];
	uint8_t public_key[ALIRO_P256_POINT];
	uint8_t guid[16];
	uint8_t pin_provisioned;
	uint8_t pin_retries;
	uint8_t reserved[2];
	uint8_t pin_salt[PIV_PIN_SALT_BYTES];
	uint8_t pin_hash[32];
	uint8_t certificate[PIV_CERT_MAX];
};

/**
 * Serialized key management blob holding a private key, public key, and certificate. Magic and
 * version fields used to detect format changes. Serial field distinguishes multiple key management
 * keys. Certificate is DER-encoded.
 */
struct piv_key_management_blob {
	uint32_t magic;
	uint16_t version;
	uint16_t certificate_len;
	uint8_t private_key[ALIRO_P256_SCALAR];
	uint8_t public_key[ALIRO_P256_POINT];
	uint8_t serial[16];
	uint8_t certificate[PIV_CERT_MAX];
};

static struct piv_identity_blob s_identity;
static struct piv_key_management_blob s_key_management;
static bool s_ready;
/* Certificate creation runs once, before USB or any other PIV caller starts.
 * Keep the reverse-writing X.509 scratch out of app_main's task stack. */
static uint8_t s_certificate_der[PIV_CERT_MAX];

/**
 * Fill a buffer with random bytes from the Aliro CSPRNG. Return 0 on success or nonzero on error.
 */
static int certificate_rng(void *ctx, unsigned char *out, size_t len)
{
	(void)ctx;
	return aliro_random(out, len);
}

/*
 * Encode an RFC 5915 ECPrivateKey around the key material generated by PSA.
 * Parsing this standard DER object lets the X.509 writer use the same key
 * without reaching into private mbedTLS structures.
 */
static int make_pk_context(const uint8_t private_key[ALIRO_P256_SCALAR],
			   const uint8_t public_key[ALIRO_P256_POINT],
			   mbedtls_pk_context *key)
{
	static const uint8_t prefix[] = {
		0x30, 0x77,
		0x02, 0x01, 0x01,
		0x04, 0x20,
	};
	static const uint8_t curve[] = {
		0xa0, 0x0a, 0x06, 0x08,
		0x2a, 0x86, 0x48, 0xce, 0x3d, 0x03, 0x01, 0x07,
		0xa1, 0x44, 0x03, 0x42, 0x00,
	};
	uint8_t der[sizeof(prefix) + ALIRO_P256_SCALAR +
		    sizeof(curve) + ALIRO_P256_POINT];
	size_t at = 0u;
	int result;

	memcpy(der + at, prefix, sizeof(prefix));
	at += sizeof(prefix);
	memcpy(der + at, private_key, ALIRO_P256_SCALAR);
	at += ALIRO_P256_SCALAR;
	memcpy(der + at, curve, sizeof(curve));
	at += sizeof(curve);
	memcpy(der + at, public_key, ALIRO_P256_POINT);
	at += ALIRO_P256_POINT;

	mbedtls_pk_init(key);
	result = mbedtls_pk_parse_key(key, der, at, NULL, 0u,
				      certificate_rng, NULL);
	memset(der, 0, sizeof(der));
	return result;
}

/**
 * Encode a self-signed X.509v3 certificate around the given P-256 key pair. Sets the subject and
 * issuer name to the same string, validity from 2026-01-01 to 2046-01-01, and key usage to the
 * provided flags. Serial is derived from serial_source, with a fallback of 1 if all bytes are zero.
 * Returns 0 on success, -1 on failure (null pointer, buffer too small, or mbedTLS operation
 * failure). Output certificate is DER-encoded at certificate and its length is written to
 * certificate_len.
 */
static int make_certificate(
	const uint8_t private_key[ALIRO_P256_SCALAR],
	const uint8_t public_key[ALIRO_P256_POINT],
	const uint8_t serial_source[16], const char *name,
	unsigned int key_usage, uint8_t *certificate,
	size_t certificate_cap, uint16_t *certificate_len)
{
	static const char not_before[] = "20260101000000";
	static const char not_after[] = "20460101000000";
	mbedtls_x509write_cert writer;
	mbedtls_pk_context key;
	uint8_t serial[16];
	uint8_t serial_nonzero = 0u;
	int length;
	int rc = -1;

	mbedtls_x509write_crt_init(&writer);
	if (certificate == NULL || certificate_len == NULL ||
	    certificate_cap == 0u ||
	    make_pk_context(private_key, public_key,
			    &key) != 0) {
		goto out_writer;
	}
	memcpy(serial, serial_source, sizeof(serial));
	for (size_t i = 0u; i < sizeof(serial); i++) {
		serial_nonzero |= serial[i];
	}
	if (serial_nonzero == 0u) {
		serial[sizeof(serial) - 1u] = 1u;
	}

	mbedtls_x509write_crt_set_version(&writer,
					 MBEDTLS_X509_CRT_VERSION_3);
	mbedtls_x509write_crt_set_md_alg(&writer, MBEDTLS_MD_SHA256);
	mbedtls_x509write_crt_set_subject_key(&writer, &key);
	mbedtls_x509write_crt_set_issuer_key(&writer, &key);
	if (mbedtls_x509write_crt_set_subject_name(&writer, name) != 0 ||
	    mbedtls_x509write_crt_set_issuer_name(&writer, name) != 0 ||
	    mbedtls_x509write_crt_set_serial_raw(&writer, serial,
						 sizeof(serial)) != 0 ||
	    mbedtls_x509write_crt_set_validity(&writer, not_before,
					       not_after) != 0 ||
	    mbedtls_x509write_crt_set_basic_constraints(&writer, 0, -1) != 0 ||
	    mbedtls_x509write_crt_set_key_usage(&writer, key_usage) != 0) {
		goto out_key;
	}
	length = mbedtls_x509write_crt_der(&writer, s_certificate_der,
					   sizeof(s_certificate_der),
					   certificate_rng, NULL);
	if (length <= 0 || (size_t)length > certificate_cap) {
		goto out_key;
	}
	memcpy(certificate,
	       s_certificate_der + sizeof(s_certificate_der) - (size_t)length,
	       (size_t)length);
	*certificate_len = (uint16_t)length;
	rc = 0;

out_key:
	mbedtls_pk_free(&key);
out_writer:
	mbedtls_x509write_crt_free(&writer);
	return rc;
}

/**
 * Persist the in-memory identity blob to NVS under the key PIV_IDENTITY_KEY. Returns 0 on success,
 * -1 on NVS failure (open, set, or commit).
 */
static int save_identity(void)
{
	nvs_handle_t handle;
	esp_err_t err = nvs_open(PIV_IDENTITY_NS, NVS_READWRITE, &handle);

	if (err != ESP_OK) {
		return -1;
	}
	err = nvs_set_blob(handle, PIV_IDENTITY_KEY,
			   &s_identity, sizeof(s_identity));
	if (err == ESP_OK) {
		err = nvs_commit(handle);
	}
	nvs_close(handle);
	return err == ESP_OK ? 0 : -1;
}

/**
 * Persist the in-memory key management blob to NVS under the key PIV_KEY_MANAGEMENT_KEY. Returns 0
 * on success, -1 on NVS failure (open, set, or commit).
 */
static int save_key_management(void)
{
	nvs_handle_t handle;
	esp_err_t err = nvs_open(PIV_IDENTITY_NS, NVS_READWRITE, &handle);

	if (err != ESP_OK) {
		return -1;
	}
	err = nvs_set_blob(handle, PIV_KEY_MANAGEMENT_KEY,
			   &s_key_management, sizeof(s_key_management));
	if (err == ESP_OK) {
		err = nvs_commit(handle);
	}
	nvs_close(handle);
	return err == ESP_OK ? 0 : -1;
}

/* Return 0 for a valid blob, 1 when no identity exists, and -1 on corruption. */
static int load_identity(void)
{
	nvs_handle_t handle;
	size_t length = sizeof(s_identity);
	uint8_t derived[ALIRO_P256_POINT];
	esp_err_t err = nvs_open(PIV_IDENTITY_NS, NVS_READONLY, &handle);

	if (err == ESP_ERR_NVS_NOT_FOUND) {
		return 1;
	}
	if (err != ESP_OK) {
		return -1;
	}
	err = nvs_get_blob(handle, PIV_IDENTITY_KEY, &s_identity, &length);
	nvs_close(handle);
	if (err == ESP_ERR_NVS_NOT_FOUND) {
		return 1;
	}
	if (err != ESP_OK || length != sizeof(s_identity) ||
	    s_identity.magic != PIV_IDENTITY_MAGIC ||
	    s_identity.version != PIV_IDENTITY_VERSION ||
	    s_identity.certificate_len == 0u ||
	    s_identity.certificate_len > sizeof(s_identity.certificate) ||
	    s_identity.public_key[0] != 0x04u ||
	    s_identity.pin_retries > PIV_PIN_RETRIES ||
	    aliro_ec_p256_pub_from_priv(s_identity.private_key, derived) != 0 ||
	    memcmp(derived, s_identity.public_key, sizeof(derived)) != 0) {
		memset(&s_identity, 0, sizeof(s_identity));
		return -1;
	}
	return 0;
}

/* Return 0 for a valid slot-9D blob, 1 when absent, and -1 on corruption. */
static int load_key_management(void)
{
	nvs_handle_t handle;
	size_t length = sizeof(s_key_management);
	uint8_t derived[ALIRO_P256_POINT];
	esp_err_t err = nvs_open(PIV_IDENTITY_NS, NVS_READONLY, &handle);

	if (err == ESP_ERR_NVS_NOT_FOUND) {
		return 1;
	}
	if (err != ESP_OK) {
		return -1;
	}
	err = nvs_get_blob(handle, PIV_KEY_MANAGEMENT_KEY,
			   &s_key_management, &length);
	nvs_close(handle);
	if (err == ESP_ERR_NVS_NOT_FOUND) {
		return 1;
	}
	if (err != ESP_OK || length != sizeof(s_key_management) ||
	    s_key_management.magic != PIV_KEY_MANAGEMENT_MAGIC ||
	    s_key_management.version != PIV_KEY_MANAGEMENT_VERSION ||
	    s_key_management.certificate_len == 0u ||
	    s_key_management.certificate_len >
		    sizeof(s_key_management.certificate) ||
	    s_key_management.public_key[0] != 0x04u ||
	    aliro_ec_p256_pub_from_priv(s_key_management.private_key,
					derived) != 0 ||
	    memcmp(derived, s_key_management.public_key,
		   sizeof(derived)) != 0) {
		memset(&s_key_management, 0, sizeof(s_key_management));
		return -1;
	}
	return 0;
}

/**
 * Return true if the PIN is valid: at least 6 ASCII decimal digits followed by padding bytes of
 * 0xff, false otherwise.
 */
static bool pin_is_valid(const uint8_t pin[PIV_PIN_BYTES])
{
	size_t digits = 0u;

	while (digits < PIV_PIN_BYTES &&
	       pin[digits] >= (uint8_t)'0' && pin[digits] <= (uint8_t)'9') {
		digits++;
	}
	if (digits < 6u) {
		return false;
	}
	for (size_t i = digits; i < PIV_PIN_BYTES; i++) {
		if (pin[i] != 0xffu) {
			return false;
		}
	}
	return true;
}

/**
 * Return true if the PIN buffer is the unset marker (all bytes 0xff), false otherwise.
 */
static bool pin_is_unset_marker(const uint8_t pin[PIV_PIN_BYTES])
{
	uint8_t different = 0u;

	for (size_t i = 0u; i < PIV_PIN_BYTES; i++) {
		different |= (uint8_t)(pin[i] ^ 0xffu);
	}
	return different == 0u;
}

/**
 * Hash a PIN with its salt using SHA-256: concatenate salt and PIN, compute the hash, and clear
 * intermediate buffers. Return 0 on success or -1 if the PSA operation fails or returns a wrong
 * length.
 */
static int hash_pin(const uint8_t salt[PIV_PIN_SALT_BYTES],
		    const uint8_t pin[PIV_PIN_BYTES],
		    uint8_t hash[32])
{
	uint8_t input[PIV_PIN_SALT_BYTES + PIV_PIN_BYTES];
	size_t hash_len = 0u;

	memcpy(input, salt, PIV_PIN_SALT_BYTES);
	memcpy(input + PIV_PIN_SALT_BYTES, pin, PIV_PIN_BYTES);
	if (psa_hash_compute(PSA_ALG_SHA_256, input, sizeof(input),
			     hash, 32u, &hash_len) != PSA_SUCCESS ||
	    hash_len != 32u) {
		memset(hash, 0, 32u);
		memset(input, 0, sizeof(input));
		return -1;
	}
	memset(input, 0, sizeof(input));
	return 0;
}

static bool pin_matches(const uint8_t pin[PIV_PIN_BYTES])
{
	uint8_t actual[32];
	uint8_t different = 0u;

	if (hash_pin(s_identity.pin_salt, pin, actual) != 0) {
		return false;
	}
	for (size_t i = 0u; i < sizeof(actual); i++) {
		different |= (uint8_t)(actual[i] ^ s_identity.pin_hash[i]);
	}
	memset(actual, 0, sizeof(actual));
	return different == 0u;
}

static int record_wrong_pin(uint8_t *retries)
{
	if (s_identity.pin_retries != 0u) {
		s_identity.pin_retries--;
	}
	if (save_identity() != 0) {
		s_ready = false;
		return -1;
	}
	*retries = s_identity.pin_retries;
	return s_identity.pin_retries == 0u ? -2 : 1;
}

/**
 * Retrieve the certificate for a given key reference (AUTH or KEY_MANAGEMENT) and return its
 * pointer and length. Return 0 on success or -1 on error or invalid key reference.
 */
static int backend_get_certificate(void *ctx, uint8_t key_ref,
				   const uint8_t **certificate,
				   size_t *certificate_len)
{
	(void)ctx;
	if (!s_ready || certificate == NULL || certificate_len == NULL) {
		return -1;
	}
	if (key_ref == PIV_KEY_REF_AUTH) {
		*certificate = s_identity.certificate;
		*certificate_len = s_identity.certificate_len;
	} else if (key_ref == PIV_KEY_REF_KEY_MANAGEMENT) {
		*certificate = s_key_management.certificate;
		*certificate_len = s_key_management.certificate_len;
	} else {
		return -1;
	}
	return 0;
}

/**
 * Copy the 16-byte GUID from the PIV identity to the caller's buffer. Return 0 on success or -1 on
 * error or if the backend is not ready.
 */
static int backend_get_guid(void *ctx, uint8_t guid[16])
{
	(void)ctx;
	if (!s_ready || guid == NULL) {
		return -1;
	}
	memcpy(guid, s_identity.guid, sizeof(s_identity.guid));
	return 0;
}

/**
 * Return the PIN retry counter and status: 0 if the PIN is provisioned and retries remain, -2 if
 * the PIN is not provisioned or retries are exhausted, -1 on error or if the backend is not ready.
 */
static int backend_pin_status(void *ctx, uint8_t *retries)
{
	(void)ctx;
	if (!s_ready || retries == NULL) {
		return -1;
	}
	*retries = s_identity.pin_retries;
	if (!s_identity.pin_provisioned || s_identity.pin_retries == 0u) {
		return -2;
	}
	return 0;
}

static int backend_verify_pin(void *ctx,
			      const uint8_t pin[PIV_PIN_BYTES],
			      uint8_t *retries)
{
	(void)ctx;
	if (!s_ready || pin == NULL || retries == NULL) {
		return -1;
	}
	*retries = s_identity.pin_retries;
	if (!s_identity.pin_provisioned || s_identity.pin_retries == 0u) {
		return -2;
	}
	if (!pin_matches(pin)) {
		return record_wrong_pin(retries);
	}
	if (s_identity.pin_retries != PIV_PIN_RETRIES) {
		s_identity.pin_retries = PIV_PIN_RETRIES;
		if (save_identity() != 0) {
			s_ready = false;
			return -1;
		}
	}
	*retries = s_identity.pin_retries;
	return 0;
}

static int backend_change_pin(void *ctx,
			      const uint8_t old_pin[PIV_PIN_BYTES],
			      const uint8_t new_pin[PIV_PIN_BYTES],
			      uint8_t *retries)
{
	struct piv_identity_blob previous;

	(void)ctx;
	if (!s_ready || old_pin == NULL || new_pin == NULL || retries == NULL ||
	    !pin_is_valid(new_pin)) {
		return -1;
	}
	*retries = s_identity.pin_retries;
	if (s_identity.pin_provisioned) {
		if (s_identity.pin_retries == 0u) {
			return -2;
		}
		if (!pin_matches(old_pin)) {
			return record_wrong_pin(retries);
		}
	} else if (!pin_is_unset_marker(old_pin)) {
		return -2;
	}

	previous = s_identity;
	if (aliro_random(s_identity.pin_salt,
			 sizeof(s_identity.pin_salt)) != 0) {
		return -1;
	}
	if (hash_pin(s_identity.pin_salt, new_pin, s_identity.pin_hash) != 0) {
		s_identity = previous;
		return -1;
	}
	s_identity.pin_provisioned = 1u;
	s_identity.pin_retries = PIV_PIN_RETRIES;
	if (save_identity() != 0) {
		s_identity = previous;
		return -1;
	}
	*retries = s_identity.pin_retries;
	return 0;
}

/**
 * Sign a 32-byte P-256 hash using the identity private key, after verifying that presence is fresh.
 * Return 0 on success or -1 on error, if the backend is not ready, or if presence validation fails.
 */
static int backend_sign_hash(void *ctx,
			     const uint8_t hash[PIV_P256_HASH_BYTES],
			     uint8_t signature[PIV_P256_RAW_SIGNATURE_BYTES])
{
	(void)ctx;
	if (!s_ready || hash == NULL || signature == NULL ||
	    presence_link_require_fresh() != 0) {
		return -1;
	}
	return aliro_ecdsa_p256_sign_hash(s_identity.private_key,
					  hash, signature);
}

/**
 * ECDH callback: compute the shared secret using the local P-256 private key and the peer's P-256
 * public key. Return 0 on success or -1 on error or if the backend is not ready.
 */
static int backend_derive_shared(
	void *ctx, const uint8_t peer_public_key[PIV_P256_POINT_BYTES],
	uint8_t shared_secret[PIV_P256_SHARED_SECRET_BYTES])
{
	(void)ctx;
	if (!s_ready || peer_public_key == NULL || shared_secret == NULL) {
		return -1;
	}
	return aliro_ecdh_p256(s_key_management.private_key,
			      peer_public_key, shared_secret);
}

static const struct piv_apdu_backend s_backend = {
	.get_certificate = backend_get_certificate,
	.get_guid = backend_get_guid,
	.pin_status = backend_pin_status,
	.verify_pin = backend_verify_pin,
	.change_pin = backend_change_pin,
	.sign_hash = backend_sign_hash,
	.derive_shared = backend_derive_shared,
};

esp_err_t piv_identity_init(void)
{
	static const char auth_name[] = "CN=OpenAliro Presence PIV";
	static const char key_management_name[] =
		"CN=OpenAliro Presence PIV Key Management";
	int auth_loaded;
	int key_management_loaded;

	s_ready = false;
	memset(&s_identity, 0, sizeof(s_identity));
	memset(&s_key_management, 0, sizeof(s_key_management));
	if (aliro_prim_init() != 0) {
		return ESP_FAIL;
	}
	auth_loaded = load_identity();
	if (auth_loaded < 0) {
		return ESP_FAIL;
	}
	if (auth_loaded > 0) {
		s_identity.magic = PIV_IDENTITY_MAGIC;
		s_identity.version = PIV_IDENTITY_VERSION;
		s_identity.pin_retries = PIV_PIN_RETRIES;
		if (aliro_ec_p256_keygen(s_identity.private_key,
					 s_identity.public_key) != 0 ||
		    aliro_random(s_identity.guid, sizeof(s_identity.guid)) != 0 ||
		    make_certificate(
			    s_identity.private_key, s_identity.public_key,
			    s_identity.guid, auth_name,
			    MBEDTLS_X509_KU_DIGITAL_SIGNATURE,
			    s_identity.certificate,
			    sizeof(s_identity.certificate),
			    &s_identity.certificate_len) != 0 ||
		    save_identity() != 0) {
			memset(&s_identity, 0, sizeof(s_identity));
			return ESP_FAIL;
		}
	}

	key_management_loaded = load_key_management();
	if (key_management_loaded < 0) {
		return ESP_FAIL;
	}
	if (key_management_loaded > 0) {
		s_key_management.magic = PIV_KEY_MANAGEMENT_MAGIC;
		s_key_management.version = PIV_KEY_MANAGEMENT_VERSION;
		if (aliro_ec_p256_keygen(s_key_management.private_key,
					 s_key_management.public_key) != 0 ||
		    aliro_random(s_key_management.serial,
				 sizeof(s_key_management.serial)) != 0 ||
		    make_certificate(
			    s_key_management.private_key,
			    s_key_management.public_key,
			    s_key_management.serial, key_management_name,
			    MBEDTLS_X509_KU_KEY_AGREEMENT,
			    s_key_management.certificate,
			    sizeof(s_key_management.certificate),
			    &s_key_management.certificate_len) != 0 ||
		    save_key_management() != 0) {
			memset(&s_key_management, 0,
			       sizeof(s_key_management));
			return ESP_FAIL;
		}
	}
	s_ready = true;
	return ESP_OK;
}

/**
 * Return a pointer to the APDU backend implementation struct for PIV identity operations.
 */
const struct piv_apdu_backend *piv_identity_backend(void)
{
	return &s_backend;
}
