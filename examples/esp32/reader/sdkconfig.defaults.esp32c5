## examples/esp32/reader/sdkconfig.defaults.esp32c5
```kconfig
# ESP32-C5 target (applied by idf.py after sdkconfig.defaults; later wins).
# 4 MB is the safe floor across ESP32-C5-WROOM-1 flash variants, so the 16 MB
# S3 partition layout shrinks to partitions_4mb.csv (factory 0x3E0000).
CONFIG_IDF_TARGET="esp32c5"
CONFIG_ESPTOOLPY_FLASHSIZE_4MB=y
CONFIG_PARTITION_TABLE_CUSTOM_FILENAME="partitions_4mb.csv"
```

## modules/ultrawidelock_nfc/dts/bindings/nfc/nxp,pn532-spi.yaml
```yaml
description: |
  NXP PN532 NFC reader controller on SPI. The controller's SPI interface is
  byte-wise LSB-first and runs in SPI mode 0; the Woz PN532 transport sets the
  LSB-first flag in the driver, so no DT property is needed for it. Readiness is
  polled with the STATREAD command by default; wire irq-gpios to the PN532 IRQ
  pad (active low when a response frame is ready) to sleep on the line instead.

compatible: "nxp,pn532-spi"

include: spi-device.yaml

properties:
  irq-gpios:
    type: phandle-array
    description: Optional response-ready interrupt line (active low).
```

## modules/woz_aliro_stack/Kconfig
```kconfig
# Clean-room Aliro stack implementation derived from the published specification.

config WOZ_ALIRO_SOURCE_STACK
	bool "Use the in-tree Aliro source implementation"
	depends on NCS_ALIRO_BLE_UWB
	help
	  Override the public Aliro symbols used by the application with the
	  in-tree implementation. NFC expedited-standard, expedited-fast,
	  step-up, and authenticated BLE/UWB messaging are implemented.

config WOZ_ALIRO_APDU_BUFFER_SIZE
	int "Aliro session APDU buffer size"
	depends on WOZ_ALIRO_SOURCE_STACK
	default RFAL_FEATURE_ISO_DEP_APDU_MAX_LEN if NFC_DRIVER_STM
	default 512
	help
	  Largest single APDU the session layer buffers, and the base of the
	  BLE frame capacity. Tracks the RFAL ISO-DEP ceiling when the ST NFC
	  driver is present so both paths agree; otherwise stands alone (the
	  PN532 transport chains larger transfers at the ISO-DEP layer).

config WOZ_ALIRO_TRACE
	bool "Trace Aliro BLE/UWB protocol boundaries"
	depends on NCS_ALIRO_BLE_UWB
	help
	  Log advertising data, encrypted BLE transport messages, decrypted UWB
	  messages, session transitions, and a truncated SHA-256 fingerprint of
	  URSK. This is a temporary bring-up facility and may expose credential or
	  device identifiers. Do not enable it in production firmware.
```

## modules/woz_nfc/Kconfig
```kconfig
# Woz NFC transport seam: selects which reader backend implements the WozNfc
# transport API consumed by the patched add-on application.

config WOZ_NFC
	bool "Woz NFC transport seam"
	help
	  Compile the WozNfc transport seam into the application. The add-on's
	  NFC call sites are patched (integration/patches/nfc-transport-seam.patch)
	  to go through this seam, so exactly one backend below must be selected
	  in any application build that links those call sites.

if WOZ_NFC

choice WOZ_NFC_TRANSPORT
	prompt "Aliro NFC reader transport"
	default WOZ_NFC_TRANSPORT_RFAL if NFC_DRIVER_STM
	default WOZ_NFC_TRANSPORT_NONE

config WOZ_NFC_TRANSPORT_RFAL
	bool "ST25R series via the upstream RFAL transport"
	depends on NFC_DRIVER_STM
	help
	  Forward the seam to the add-on's NfcTransportRfal (X-NUCLEO ST25R500
	  shield on spi1). Upstream behavior, byte for byte.

config WOZ_NFC_TRANSPORT_PN532
	bool "NXP PN532 over SPI"
	depends on SPI
	help
	  In-tree PN532 reader transport. Needs a devicetree node compatible
	  "nxp,pn532-spi" (see integration/overlays/pn532.overlay, which reuses
	  the spi1 bus the ST25R shield would occupy). Emits Apple ECP frames
	  while polling so an iPhone auto-presents its Aliro pass, mirroring the
	  woz_aliro_ecp module on the RFAL path.

config WOZ_NFC_TRANSPORT_NONE
	bool "No NFC reader fitted"
	help
	  The board has no NFC frontend. Start() succeeds without doing
	  anything; the Aliro NFC flow is simply never entered. BLE/UWB and
	  Matter operate normally.

endchoice

if WOZ_NFC_TRANSPORT_PN532

config WOZ_NFC_PN532_THREAD_STACK_SIZE
	int "PN532 transport thread stack size"
	default 3072

config WOZ_NFC_PN532_POLL_PERIOD_MS
	int "Polling period between discovery rounds (ms)"
	default 96
	help
	  Delay with the RF field off between polling rounds. Each round emits
	  one ECP frame and one 106 kbps type A activation attempt.

config WOZ_NFC_PN532_EXCHANGE_TIMEOUT_MS
	int "APDU exchange response timeout (ms)"
	default 5000
	help
	  Upper bound on one InDataExchange round trip. The PN532 services
	  ISO-DEP WTX requests autonomously, and a User Device performing user
	  authentication can legitimately stretch a response several seconds.

endif # WOZ_NFC_TRANSPORT_PN532

module = WOZ_NFC
module-str = woz_nfc
source "$(ZEPHYR_BASE)/subsys/logging/Kconfig.template.log_config"

endif # WOZ_NFC
```
