## CMakeLists.txt
```
# Experimental secondary UWB observer (nRF5340 DK + DWM3000EVB).
cmake_minimum_required(VERSION 3.20.0)

get_filename_component(REPO_ROOT "${CMAKE_CURRENT_LIST_DIR}/../../.." ABSOLUTE)

list(APPEND ZEPHYR_EXTRA_MODULES
	"${REPO_ROOT}/modules/woz_uwb"
	"${REPO_ROOT}/modules/woz_dw3000"
	"${REPO_ROOT}/ports/zephyr")

find_package(Zephyr REQUIRED HINTS $ENV{ZEPHYR_BASE})
project(openaliro_secondary_uwb)

target_sources(app PRIVATE src/main.c)
```

## prj.conf
```kconfig
# Scaffold only: prove bring-up before attempting passive iPhone UWB observe.

CONFIG_SPI=y
CONFIG_DW3000=y
CONFIG_DW3000_CHIP_DW3000=y
CONFIG_WOZ_UWB=y
CONFIG_WOZ_UWB_SHELL=n

CONFIG_LOG=y
CONFIG_LOG_DEFAULT_LEVEL=3
CONFIG_USE_SEGGER_RTT=y
CONFIG_RTT_CONSOLE=y
CONFIG_UART_CONSOLE=n
CONFIG_MAIN_STACK_SIZE=4096
CONFIG_BT=n
CONFIG_NETWORKING=n
```

## src/main.c
```c
/**
 * @file main.c — experimental secondary UWB observer on nRF5340 + DWM3000EVB.
 *
 * Goal: determine whether a second DW3000 can usefully observe the stock
 * iPhone UWB exchange already driven by the primary DWM3001CDK lock.
 *
 * This image does NOT assume success. It:
 *   - brings up the DW3000
 *   - listens for energy / frames on the FiRa/CCC channel when configured
 *   - logs receive-power style diagnostics over RTT/UART
 *   - never logs session keys or long-lived credentials
 *   - never commands an unlock
 *
 * Independent secondary ranging to the iPhone is attempted only if the
 * protocol configuration is explicitly provided by a short-lived, local
 * experiment harness — not by reading production secrets from the lock.
 *
 * Build (requires workspace + DWM3000EVB shield overlay on the DK):
 *   make secondary-uwb-build
 */

#include <zephyr/kernel.h>
#include <zephyr/logging/log.h>

LOG_MODULE_REGISTER(sec_uwb, LOG_LEVEL_INF);

int main(void)
{
	LOG_INF("secondary-uwb experiment: nRF5340 + DWM3000EVB");
	LOG_INF("status=scaffold — passive iPhone UWB observe not yet proven");
	LOG_INF("unsupported until demonstrated: multi-anchor iPhone UWB ranging");
	LOG_INF("this node cannot unlock the door");

	for (;;) {
		k_sleep(K_SECONDS(5));
		LOG_INF("alive; awaiting experiment harness configuration");
	}
	return 0;
}
```
